## car-camera/main/Kconfig.projbuild
```kconfig
menu "Smart Camera Car Configuration"

    menu "Wi-Fi AP"
        config CAR_WIFI_AP_SSID
            string "AP SSID"
            default "ESP32S3-Car"

        config CAR_WIFI_AP_PASSWORD
            string "AP password"
            default "12345678"
            help
                WPA/WPA2 password. Use at least 8 characters, or leave empty for an open AP.

        config CAR_WIFI_AP_CHANNEL
            int "AP channel"
            default 6
            range 1 13

        config CAR_WIFI_MAX_STA
            int "Max connected stations"
            default 4
            range 1 8
    endmenu

    menu "Camera"
        config CAR_CAM_PIN_PWDN
            int "PWDN GPIO (-1 disables)"
            default -1
            range -1 48

        config CAR_CAM_PIN_RESET
            int "RESET GPIO (-1 disables)"
            default -1
            range -1 48

        config CAR_CAM_PIN_XCLK
            int "XCLK GPIO"
            default 15
            range 0 48

        config CAR_CAM_PIN_SIOD
            int "SIOD/SDA GPIO"
            default 4
            range 0 48

        config CAR_CAM_PIN_SIOC
            int "SIOC/SCL GPIO"
            default 5
            range 0 48

        config CAR_CAM_PIN_D7
            int "D7/Y9 GPIO"
            default 16
            range 0 48

        config CAR_CAM_PIN_D6
            int "D6/Y8 GPIO"
            default 17
            range 0 48

        config CAR_CAM_PIN_D5
            int "D5/Y7 GPIO"
            default 18
            range 0 48

        config CAR_CAM_PIN_D4
            int "D4/Y6 GPIO"
            default 12
            range 0 48

        config CAR_CAM_PIN_D3
            int "D3/Y5 GPIO"
            default 10
            range 0 48

        config CAR_CAM_PIN_D2
            int "D2/Y4 GPIO"
            default 8
            range 0 48

        config CAR_CAM_PIN_D1
            int "D1/Y3 GPIO"
            default 9
            range 0 48

        config CAR_CAM_PIN_D0
            int "D0/Y2 GPIO"
            default 11
            range 0 48

        config CAR_CAM_PIN_VSYNC
            int "VSYNC GPIO"
            default 6
            range 0 48

        config CAR_CAM_PIN_HREF
            int "HREF GPIO"
            default 7
            range 0 48

        config CAR_CAM_PIN_PCLK
            int "PCLK GPIO"
            default 13
            range 0 48

        config CAR_CAM_XCLK_FREQ_HZ
            int "XCLK frequency"
            default 20000000
            range 10000000 24000000

        choice CAR_CAMERA_FRAME_SIZE
            prompt "Default stream frame size"
            default CAR_CAMERA_FRAME_SIZE_QVGA

            config CAR_CAMERA_FRAME_SIZE_QQVGA
                bool "QQVGA 160x120"

            config CAR_CAMERA_FRAME_SIZE_QVGA
                bool "QVGA 320x240"

            config CAR_CAMERA_FRAME_SIZE_VGA
                bool "VGA 640x480"
        endchoice

        config CAR_CAMERA_JPEG_QUALITY
            int "JPEG quality, lower is better"
            default 12
            range 5 35

        config CAR_CAMERA_FB_COUNT
            int "Frame buffer count"
            default 2
            range 1 3
    endmenu

    menu "Motor Driver"
        config CAR_MOTOR_LEFT_PWM_GPIO
            int "Left motor PWM GPIO"
            default 14
            range 0 48

        config CAR_MOTOR_LEFT_IN1_GPIO
            int "Left motor IN1 GPIO"
            default 1
            range 0 48

        config CAR_MOTOR_LEFT_IN2_GPIO
            int "Left motor IN2 GPIO"
            default 2
            range 0 48

        config CAR_MOTOR_RIGHT_PWM_GPIO
            int "Right motor PWM GPIO"
            default 21
            range 0 48

        config CAR_MOTOR_RIGHT_IN1_GPIO
            int "Right motor IN1 GPIO"
            default 39
            range 0 48

        config CAR_MOTOR_RIGHT_IN2_GPIO
            int "Right motor IN2 GPIO"
            default 40
            range 0 48

        config CAR_MOTOR_STBY_GPIO
            int "Motor standby GPIO (-1 disables)"
            default 41
            range -1 48

        config CAR_MOTOR_PWM_FREQ_HZ
            int "Motor PWM frequency"
            default 1000
            range 100 20000

        config CAR_MOTOR_DEFAULT_SPEED
            int "Default speed percent"
            default 60
            range 0 100

        config CAR_MOTOR_FAILSAFE_MS
            int "Motor failsafe timeout ms"
            default 900
            range 200 5000

        config CAR_MOTOR_INVERT_LEFT
            bool "Invert left motor direction"
            default n

        config CAR_MOTOR_INVERT_RIGHT
            bool "Invert right motor direction"
            default n
    endmenu

    menu "Ultrasonic Obstacle Avoidance"
        config CAR_ENABLE_ULTRASONIC
            bool "Enable HC-SR04"
            default y

        config CAR_ULTRASONIC_TRIG_GPIO
            int "TRIG GPIO"
            default 42
            range 0 48
            depends on CAR_ENABLE_ULTRASONIC

        config CAR_ULTRASONIC_ECHO_GPIO
            int "ECHO GPIO"
            default 47
            range 0 48
            depends on CAR_ENABLE_ULTRASONIC

        config CAR_OBSTACLE_STOP_CM
            int "Stop distance cm"
            default 20
            range 5 200
            depends on CAR_ENABLE_ULTRASONIC

        config CAR_ULTRASONIC_PERIOD_MS
            int "Measure period ms"
            default 120
            range 60 1000
            depends on CAR_ENABLE_ULTRASONIC
    endmenu

    config CAR_STATUS_LED_GPIO
        int "Status LED GPIO (-1 disables)"
        default 48
        range -1 48

endmenu
```

## car-display/camera/main/Kconfig.projbuild
```kconfig
menu "车辆盲区摄像头配置"

    menu "摄像头引脚配置"
        comment "左侧摄像头引脚 (OV2640)"

        config CAM_LEFT_PWDN_GPIO
            int "左摄像头 PWDN GPIO"
            default 1
            help
                左侧摄像头电源控制引脚，低电平有效

        config CAM_LEFT_RESET_GPIO
            int "左摄像头 RESET GPIO"
            default 2
            help
                左侧摄像头复位引脚，低电平有效

        comment "右侧摄像头引脚 (OV2640)"

        config CAM_RIGHT_PWDN_GPIO
            int "右摄像头 PWDN GPIO"
            default 3
            help
                右侧摄像头电源控制引脚，低电平有效

        config CAM_RIGHT_RESET_GPIO
            int "右摄像头 RESET GPIO"
            default 46
            help
                右侧摄像头复位引脚，低电平有效

        comment "共享摄像头引脚 (DVP接口)"

        config CAM_XCLK_GPIO
            int "摄像头 XCLK GPIO"
            default 15
            help
                摄像头时钟输出引脚

        config CAM_PCLK_GPIO
            int "摄像头 PCLK GPIO"
            default 13
            help
                摄像头像素时钟引脚

        config CAM_VSYNC_GPIO
            int "摄像头 VSYNC GPIO"
            default 6
            help
                摄像头垂直同步引脚

        config CAM_HREF_GPIO
            int "摄像头 HREF GPIO"
            default 7
            help
                摄像头水平参考引脚

        config CAM_D0_GPIO
            int "摄像头 D0 GPIO"
            default 11

        config CAM_D1_GPIO
            int "摄像头 D1 GPIO"
            default 9

        config CAM_D2_GPIO
            int "摄像头 D2 GPIO"
            default 8

        config CAM_D3_GPIO
            int "摄像头 D3 GPIO"
            default 10

        config CAM_D4_GPIO
            int "摄像头 D4 GPIO"
            default 12

        config CAM_D5_GPIO
            int "摄像头 D5 GPIO"
            default 18

        config CAM_D6_GPIO
            int "摄像头 D6 GPIO"
            default 17

        config CAM_D7_GPIO
            int "摄像头 D7 GPIO"
            default 16

        config CAM_SDA_GPIO
            int "摄像头 I2C SDA GPIO"
            default 4

        config CAM_SCL_GPIO
            int "摄像头 I2C SCL GPIO"
            default 5
    endmenu

    menu "LCD显示屏引脚配置 (ST7789/ILI9341 SPI)"

        config LCD_MOSI_GPIO
            int "LCD MOSI GPIO"
            default 35

        config LCD_SCLK_GPIO
            int "LCD SCLK GPIO"
            default 36

        config LCD_CS_GPIO
            int "LCD CS GPIO"
            default 34

        config LCD_DC_GPIO
            int "LCD DC GPIO"
            default 33

        config LCD_RST_GPIO
            int "LCD RST GPIO"
            default 37

        config LCD_BL_GPIO
            int "LCD 背光 GPIO"
            default 38

        config LCD_WIDTH
            int "LCD 宽度 (像素)"
            default 320

        config LCD_HEIGHT
            int "LCD 高度 (像素)"
            default 240

        config LCD_SPI_CLOCK_HZ
            int "LCD SPI 时钟频率 (Hz)"
            default 40000000
            help
                LCD SPI总线时钟频率，最大80MHz
    endmenu

    menu "转向灯检测引脚配置"

        config TURN_LEFT_GPIO
            int "左转向灯检测 GPIO"
            default 39
            help
                左转向灯信号输入引脚，高电平表示左转

        config TURN_RIGHT_GPIO
            int "右转向灯检测 GPIO"
            default 40
            help
                右转向灯信号输入引脚，高电平表示右转

        config TURN_SIGNAL_DEBOUNCE_MS
            int "转向灯防抖时间 (ms)"
            default 50
    endmenu

    menu "摄像头采集参数"

        config CAM_FRAME_WIDTH
            int "摄像头帧宽度"
            default 320
            help
                摄像头采集分辨率宽度

        config CAM_FRAME_HEIGHT
            int "摄像头帧高度"
            default 240
            help
                摄像头采集分辨率高度

        config CAM_XCLK_FREQ_HZ
            int "摄像头 XCLK 频率 (Hz)"
            default 20000000

        config CAM_SWITCH_DELAY_MS
            int "摄像头切换延迟 (ms)"
            default 50
            help
                切换左右摄像头时的稳定等待时间

        config CAM_FRAME_RATE
            int "目标帧率 (fps)"
            default 15
            range 5 30
    endmenu

    menu "盲区警告配置"

        config BLIND_SPOT_WARNING_ENABLED
            bool "启用盲区警告叠加"
            default y
            help
                在摄像头画面上叠加距离警告颜色框

        config BLIND_SPOT_WARN_THRESHOLD
            int "警告距离阈值 (像素占比%)"
            default 30
            help
                当检测到物体占画面宽度超过此比例时显示警告

        config BLIND_SPOT_DANGER_THRESHOLD
            int "危险距离阈值 (像素占比%)"
            default 50
            help
                当检测到物体占画面宽度超过此比例时显示危险警告
    endmenu

endmenu
```

## car-display/camera/sdkconfig.defaults
```kconfig
# ESP32-S3 车辆盲区摄像头显示系统配置

# 目标芯片
CONFIG_IDF_TARGET="esp32s3"

# Flash 配置
CONFIG_ESPTOOLPY_FLASHSIZE_8MB=y
CONFIG_ESPTOOLPY_FLASHSIZE="8MB"
CONFIG_ESPTOOLPY_FLASHMODE_QIO=y
CONFIG_ESPTOOLPY_FLASHFREQ_80M=y

# PSRAM 配置 (ESP32-S3 需要 PSRAM 存储摄像头帧缓冲)
CONFIG_ESP32S3_SPIRAM_SUPPORT=y
CONFIG_SPIRAM_MODE_OCT=y
CONFIG_SPIRAM_SPEED_80M=y
CONFIG_SPIRAM_USE_MALLOC=y
CONFIG_SPIRAM_MALLOC_ALWAYSINTERNAL=16384
CONFIG_SPIRAM_TRY_ALLOCATE_WIFI_LWIP=y

# 摄像头配置
CONFIG_CAMERA_TASK_STACK_SIZE=4096

# FreeRTOS 配置
CONFIG_FREERTOS_HZ=1000
CONFIG_FREERTOS_UNICORE=n

# 日志级别
CONFIG_LOG_DEFAULT_LEVEL_INFO=y
CONFIG_LOG_DEFAULT_LEVEL=3

# 任务看门狗
CONFIG_ESP_TASK_WDT_TIMEOUT_S=10

# SPI Flash
CONFIG_SPI_FLASH_USE_LEGACY_IMPL=n

# 内存优化
CONFIG_ESP32S3_DEFAULT_CPU_FREQ_240=y
CONFIG_ESP32S3_DEFAULT_CPU_FREQ_MHZ=240

# 摄像头 DMA
CONFIG_CAMERA_DMA_BUFFER_SIZE_MAX=32768
```

## car-display/sdkconfig.defaults
```kconfig
# ESP32-S3 Car Display - Default Configuration

# Target
CONFIG_IDF_TARGET="esp32s3"

# Flash
CONFIG_ESPTOOLPY_FLASHSIZE_4MB=y
CONFIG_ESPTOOLPY_FLASHFREQ_80M=y
CONFIG_ESPTOOLPY_FLASHMODE_QIO=y

# PSRAM (ESP32-S3 with PSRAM)
CONFIG_ESP32S3_SPIRAM_SUPPORT=y
CONFIG_SPIRAM_MODE_OCT=y
CONFIG_SPIRAM_SPEED_80M=y
CONFIG_SPIRAM_USE_MALLOC=y

# FreeRTOS
CONFIG_FREERTOS_HZ=1000
CONFIG_FREERTOS_UNICORE=n

# Log level
CONFIG_LOG_DEFAULT_LEVEL_INFO=y
CONFIG_LOG_MAXIMUM_LEVEL_DEBUG=y

# Bluetooth 禁用（使用语音模块替代）
CONFIG_BT_ENABLED=n

# UART
CONFIG_UART_ISR_IN_IRAM=y

# I2C
CONFIG_I2C_ISR_IN_IRAM=n

# SPI
CONFIG_SPI_MASTER_ISR_IN_IRAM=y

# NVS
CONFIG_NVS_ASSERT_ERROR_CHECK=n

# Stack sizes
CONFIG_ESP_MAIN_TASK_STACK_SIZE=8192
CONFIG_ESP_SYSTEM_EVENT_TASK_STACK_SIZE=4096

# Compiler
CONFIG_COMPILER_OPTIMIZATION_PERF=y

# LVGL
CONFIG_LV_MEM_SIZE_KILOBYTES=64
CONFIG_LV_ATTRIBUTE_FAST_MEM_USE_IRAM=y
```
