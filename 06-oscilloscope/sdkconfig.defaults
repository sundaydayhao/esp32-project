## 06-oscilloscope/sdkconfig.defaults
```kconfig
# ESP32-S3 Oscilloscope Default Configuration

# Target
CONFIG_IDF_TARGET="esp32s3"

# WiFi
CONFIG_ESP_WIFI_SSID="Oscilloscope"
CONFIG_ESP_WIFI_PASSWORD="12345678"
CONFIG_ESP_WIFI_CHANNEL=1
CONFIG_ESP_MAX_STA_CONN=4

# HTTP Server
CONFIG_HTTPD_MAX_REQ_HDR_LEN=1024
CONFIG_HTTPD_WS_SUPPORT=y

# ADC
CONFIG_ADC_SUPPRESS_DEPRECATE_WARN=y

# FreeRTOS
CONFIG_FREERTOS_HZ=1000

# Flash size
CONFIG_ESPTOOLPY_FLASHSIZE_4MB=y
CONFIG_ESPTOOLPY_FLASHSIZE="4MB"

# Partition table
CONFIG_PARTITION_TABLE_CUSTOM=y
CONFIG_PARTITION_TABLE_CUSTOM_FILENAME="partitions.csv"

# SPIFFS
CONFIG_SPIFFS_MAX_PARTITIONS=3

# Log level
CONFIG_LOG_DEFAULT_LEVEL_INFO=y
CONFIG_LOG_DEFAULT_LEVEL=3

# Stack sizes
CONFIG_ESP_MAIN_TASK_STACK_SIZE=8192

# LwIP
CONFIG_LWIP_MAX_SOCKETS=16
CONFIG_LWIP_TCP_SND_BUF_DEFAULT=5744
CONFIG_LWIP_TCP_WND_DEFAULT=5744
```

## ai-english-trainer/main/Kconfig.projbuild
```kconfig
menu "AI English Trainer Configuration"

    menu "WiFi Settings"
        config WIFI_SSID
            string "WiFi SSID"
            default "MyWiFi"
            help
                SSID (network name) of the WiFi network to connect to.

        config WIFI_PASSWORD
            string "WiFi Password"
            default "password"
            help
                WiFi password (WPA/WPA2).

        config WIFI_MAXIMUM_RETRY
            int "Maximum WiFi retry count"
            default 5
            help
                Maximum number of WiFi connection retries before giving up.
    endmenu

    menu "OpenAI Settings"
        config OPENAI_API_KEY
            string "OpenAI API Key"
            default "sk-your-api-key-here"
            help
                Your OpenAI API key. Get it from https://platform.openai.com/api-keys

        config OPENAI_GPT_MODEL
            string "GPT Model"
            default "gpt-4o-mini"
            help
                OpenAI GPT model to use. Options: gpt-4o-mini, gpt-4o, gpt-4-turbo

        config OPENAI_TTS_VOICE
            string "TTS Voice"
            default "nova"
            help
                OpenAI TTS voice. Options: alloy, echo, fable, onyx, nova, shimmer
                Recommended for children: nova (warm, friendly female voice)

        config OPENAI_TTS_SPEED
            string "TTS Speed"
            default "0.9"
            help
                TTS playback speed (0.25 to 4.0). Slightly slower for children.
    endmenu

    menu "Hardware Pin Configuration"
        comment "I2S Microphone (INMP441)"
        config I2S_MIC_SCK_PIN
            int "Microphone SCK (Bit Clock) GPIO"
            default 14
            range 0 48

        config I2S_MIC_WS_PIN
            int "Microphone WS (Word Select/LRC) GPIO"
            default 15
            range 0 48

        config I2S_MIC_SD_PIN
            int "Microphone SD (Data) GPIO"
            default 16
            range 0 48

        comment "I2S Speaker (MAX98357A)"
        config I2S_SPK_BCLK_PIN
            int "Speaker BCLK (Bit Clock) GPIO"
            default 17
            range 0 48

        config I2S_SPK_LRC_PIN
            int "Speaker LRC (Word Select) GPIO"
            default 18
            range 0 48

        config I2S_SPK_DIN_PIN
            int "Speaker DIN (Data) GPIO"
            default 8
            range 0 48

        comment "Button and LED"
        config BUTTON_GPIO
            int "Push-to-Talk Button GPIO"
            default 0
            range 0 48
            help
                GPIO for push-to-talk button. Default 0 = BOOT button on DevKit.

        config LED_GPIO
            int "WS2812 RGB LED GPIO"
            default 48
            range 0 48
            help
                GPIO for WS2812 RGB LED. GPIO 48 on ESP32-S3-DevKitC-1.
    endmenu

    menu "Audio Settings"
        config AUDIO_SAMPLE_RATE_MIC
            int "Microphone Sample Rate (Hz)"
            default 16000
            help
                Sample rate for microphone capture. 16000 Hz recommended for Whisper API.

        config AUDIO_MAX_RECORD_SECONDS
            int "Maximum Recording Duration (seconds)"
            default 10
            range 3 30
            help
                Maximum duration for a single recording session.

        config AUDIO_SILENCE_THRESHOLD
            int "Silence Detection Threshold"
            default 500
            range 100 5000
            help
                RMS amplitude threshold below which audio is considered silence.

        config AUDIO_SILENCE_DURATION_MS
            int "Auto-stop Silence Duration (ms)"
            default 1500
            range 500 5000
            help
                Duration of silence (ms) before auto-stopping recording.
    endmenu

endmenu
```

## ai-english-trainer/sdkconfig.defaults
```kconfig
# ESP32-S3 AI English Trainer - Default SDK Configuration

# Target
CONFIG_IDF_TARGET="esp32s3"

# Flash size 8MB
CONFIG_ESPTOOLPY_FLASHSIZE_8MB=y
CONFIG_ESPTOOLPY_FLASHSIZE="8MB"

# Enable PSRAM (8MB OPI PSRAM on ESP32-S3)
CONFIG_ESP32S3_SPIRAM_SUPPORT=y
CONFIG_SPIRAM_MODE_OCT=y
CONFIG_SPIRAM_SPEED_80M=y
CONFIG_SPIRAM_USE_MALLOC=y
CONFIG_SPIRAM_MALLOC_ALWAYSINTERNAL=16384
CONFIG_SPIRAM_TRY_ALLOCATE_WIFI_LWIP=y

# Partition table
CONFIG_PARTITION_TABLE_CUSTOM=y
CONFIG_PARTITION_TABLE_CUSTOM_FILENAME="partitions.csv"

# WiFi
CONFIG_ESP_WIFI_STATIC_RX_BUFFER_NUM=10
CONFIG_ESP_WIFI_DYNAMIC_RX_BUFFER_NUM=32
CONFIG_ESP_WIFI_TX_BUFFER_TYPE_DYNAMIC=y

# TCP/IP stack - increase buffers for audio streaming
CONFIG_LWIP_TCP_SND_BUF_DEFAULT=65535
CONFIG_LWIP_TCP_WND_DEFAULT=65535
CONFIG_LWIP_TCP_RECVMBOX_SIZE=32
CONFIG_LWIP_TCPIP_RECVMBOX_SIZE=32

# TLS - mbedTLS
CONFIG_MBEDTLS_SSL_MAX_CONTENT_LEN=16384
CONFIG_MBEDTLS_DYNAMIC_BUFFER=y
CONFIG_MBEDTLS_DYNAMIC_FREE_PEER_CERT=y
CONFIG_MBEDTLS_DYNAMIC_FREE_CONFIG_DATA=y

# HTTP client
CONFIG_ESP_HTTP_CLIENT_ENABLE_HTTPS=y

# Stack sizes
CONFIG_ESP_MAIN_TASK_STACK_SIZE=8192
CONFIG_ESP_SYSTEM_EVENT_TASK_STACK_SIZE=4096

# Logging
CONFIG_LOG_DEFAULT_LEVEL_INFO=y
CONFIG_LOG_MAXIMUM_LEVEL_DEBUG=y

# FreeRTOS
CONFIG_FREERTOS_HZ=1000
CONFIG_FREERTOS_USE_TRACE_FACILITY=y

# I2S
CONFIG_I2S_ISR_IRAM_SAFE=y

# Enable USB Serial/JTAG for ESP32-S3
CONFIG_ESP_CONSOLE_USB_SERIAL_JTAG=y
```

## ai-garbage-recognition/sdkconfig.defaults
```kconfig
# ESP-IDF SDK 默认配置
# AI 智能垃圾分类系统 - ESP32-S3

# ============================================================
# 目标芯片配置 / Target Chip
# ============================================================
CONFIG_IDF_TARGET="esp32s3"

# ============================================================
# Flash 配置 / Flash Configuration
# ============================================================
CONFIG_ESPTOOLPY_FLASHSIZE_8MB=y
CONFIG_ESPTOOLPY_FLASHSIZE="8MB"
CONFIG_ESPTOOLPY_FLASHMODE_QIO=y
CONFIG_ESPTOOLPY_FLASHFREQ_80M=y

# ============================================================
# PSRAM 配置 / PSRAM Configuration (ESP32-S3 内置 PSRAM)
# ============================================================
CONFIG_ESP32S3_SPIRAM_SUPPORT=y
CONFIG_SPIRAM_MODE_OCT=y
CONFIG_SPIRAM_SPEED_80M=y
CONFIG_SPIRAM_USE_MALLOC=y
CONFIG_SPIRAM_MALLOC_ALWAYSINTERNAL=16384
CONFIG_SPIRAM_TRY_ALLOCATE_WIFI_LWIP=y

# ============================================================
# CPU 频率 / CPU Frequency
# ============================================================
CONFIG_ESP_DEFAULT_CPU_FREQ_MHZ_240=y
CONFIG_ESP_DEFAULT_CPU_FREQ_MHZ=240

# ============================================================
# FreeRTOS 配置 / FreeRTOS Configuration
# ============================================================
CONFIG_FREERTOS_HZ=1000
CONFIG_FREERTOS_USE_TRACE_FACILITY=y

# ============================================================
# 摄像头配置 / Camera Configuration
# ============================================================
CONFIG_CAMERA_TASK_STACK_SIZE=8192

# ============================================================
# 日志配置 / Log Configuration
# ============================================================
CONFIG_LOG_DEFAULT_LEVEL_INFO=y
CONFIG_LOG_MAXIMUM_LEVEL_DEBUG=y

# ============================================================
# UART 配置 / UART Configuration (DFPlayer Mini)
# ============================================================
CONFIG_UART_ISR_IN_IRAM=y

# ============================================================
# GPIO 配置 / GPIO Configuration
# ============================================================
CONFIG_GPIO_ESP32_SUPPORT_SWITCH_SLP_PULL=y

# ============================================================
# 分区表 / Partition Table
# ============================================================
CONFIG_PARTITION_TABLE_CUSTOM=y
CONFIG_PARTITION_TABLE_CUSTOM_FILENAME="partitions.csv"

# ============================================================
# 堆内存配置 / Heap Configuration
# ============================================================
CONFIG_HEAP_POISONING_DISABLED=y
CONFIG_ESP_SYSTEM_EVENT_TASK_STACK_SIZE=4096

# ============================================================
# 编译优化 / Compiler Optimization
# ============================================================
CONFIG_COMPILER_OPTIMIZATION_PERF=y
```

## ai-story-player/firmware/sdkconfig.defaults
```kconfig
# ESP32-S3 AI 睡前故事机 默认配置

# 目标芯片
CONFIG_IDF_TARGET="esp32s3"

# Flash 大小
CONFIG_ESPTOOLPY_FLASHSIZE_8MB=y
CONFIG_ESPTOOLPY_FLASHSIZE="8MB"

# PSRAM 配置 (ESP32-S3 内置 PSRAM)
CONFIG_ESP32S3_SPIRAM_SUPPORT=y
CONFIG_SPIRAM_MODE_OCT=y
CONFIG_SPIRAM_SPEED_80M=y

# WiFi 配置
CONFIG_ESP_WIFI_STATIC_RX_BUFFER_NUM=10
CONFIG_ESP_WIFI_DYNAMIC_RX_BUFFER_NUM=32
CONFIG_ESP_WIFI_TX_BUFFER_TYPE_DYNAMIC=y

# WebSocket 配置
CONFIG_WS_TRANSPORT_MAX_CONTROL_FRAME_BUFFER_LEN=128
CONFIG_WS_BUFFER_SIZE=4096

# HTTP 客户端
CONFIG_ESP_HTTP_CLIENT_ENABLE_HTTPS=y
CONFIG_ESP_HTTP_CLIENT_ENABLE_BASIC_AUTH=y

# 任务栈大小
CONFIG_ESP_MAIN_TASK_STACK_SIZE=8192

# 日志级别
CONFIG_LOG_DEFAULT_LEVEL_INFO=y
CONFIG_LOG_MAXIMUM_LEVEL_DEBUG=y

# FreeRTOS
CONFIG_FREERTOS_HZ=1000
CONFIG_FREERTOS_USE_TRACE_FACILITY=y

# I2S 音频
CONFIG_I2S_ISR_IRAM_SAFE=y

# SPI Flash
CONFIG_SPI_FLASH_SUPPORT_ISSI_CHIP=y
CONFIG_SPI_FLASH_SUPPORT_MXIC_CHIP=y
CONFIG_SPI_FLASH_SUPPORT_GD_CHIP=y
CONFIG_SPI_FLASH_SUPPORT_WINBOND_CHIP=y

# 内存优化
CONFIG_HEAP_POISONING_DISABLED=y
CONFIG_NEWLIB_STDOUT_LINE_ENDING_CRLF=y
```

## ai-toy/firmware/sdkconfig.defaults
```kconfig
# ESP32-S3 AI玩具 默认配置

# 目标芯片
CONFIG_IDF_TARGET="esp32s3"

# Flash 配置
CONFIG_ESPTOOLPY_FLASHSIZE_4MB=y
CONFIG_ESPTOOLPY_FLASHMODE_QIO=y
CONFIG_ESPTOOLPY_FLASHFREQ_80M=y

# PSRAM 配置 (ESP32-S3 OPI PSRAM)
CONFIG_ESP32S3_SPIRAM_SUPPORT=y
CONFIG_SPIRAM_MODE_OCT=y
CONFIG_SPIRAM_SPEED_80M=y
CONFIG_SPIRAM_USE_MALLOC=y
CONFIG_SPIRAM_MALLOC_ALWAYSINTERNAL=16384

# FreeRTOS 配置
CONFIG_FREERTOS_HZ=1000
CONFIG_FREERTOS_UNICORE=n

# 日志级别
CONFIG_LOG_DEFAULT_LEVEL_INFO=y
CONFIG_LOG_MAXIMUM_LEVEL_DEBUG=y

# WiFi 配置
CONFIG_ESP_WIFI_STATIC_RX_BUFFER_NUM=10
CONFIG_ESP_WIFI_DYNAMIC_RX_BUFFER_NUM=32
CONFIG_ESP_WIFI_TX_BUFFER_TYPE_DYNAMIC=y

# TCP/IP 配置
CONFIG_LWIP_TCP_SND_BUF_DEFAULT=65535
CONFIG_LWIP_TCP_WND_DEFAULT=65535
CONFIG_LWIP_TCP_RECVMBOX_SIZE=32
CONFIG_LWIP_UDP_RECVMBOX_SIZE=16
CONFIG_LWIP_TCPIP_RECVMBOX_SIZE=32

# WebSocket / HTTP 配置
CONFIG_ESP_WEBSOCKET_CLIENT_BUFFER_SIZE=8192
CONFIG_WS_TRANSPORT_MAX_CONTROL_FRAME_BUFFER_LEN=128

# 音频相关 - 增大 I2S DMA 缓冲
CONFIG_ADC_DISABLE_DAC=y

# 任务栈大小
CONFIG_ESP_MAIN_TASK_STACK_SIZE=8192

# NVS 配置
CONFIG_NVS_ENCRYPTION=n

# 分区表
CONFIG_PARTITION_TABLE_CUSTOM=y
CONFIG_PARTITION_TABLE_CUSTOM_FILENAME="partitions.csv"

# 编译优化
CONFIG_COMPILER_OPTIMIZATION_PERF=y
```

## as608/main/Kconfig.projbuild
```kconfig
menu "AS608 Fingerprint Example"

    menu "AS608 UART"

        config AS608_UART_NUM
            int "UART port number"
            default 1
            range 0 2
            help
                ESP-IDF UART port used to talk to the AS608 module.

        config AS608_UART_TX_GPIO
            int "ESP32 TX GPIO"
            default 17
            range -1 48
            help
                Connect this ESP32-S3 GPIO to AS608 RX.

        config AS608_UART_RX_GPIO
            int "ESP32 RX GPIO"
            default 18
            range -1 48
            help
                Connect this ESP32-S3 GPIO to AS608 TX.

        config AS608_BAUD_RATE
            int "UART baud rate"
            default 57600
            range 9600 115200
            help
                Most AS608/R30x-compatible modules default to 57600 baud.

        config AS608_UART_RX_BUFFER_SIZE
            int "UART RX buffer size"
            default 1024
            range 256 4096

        config AS608_COMMAND_TIMEOUT_MS
            int "Command response timeout (ms)"
            default 1200
            range 100 10000

        config AS608_POWER_ON_DELAY_MS
            int "Power-up delay before first command (ms)"
            default 500
            range 0 5000
            help
                Increase this if the sensor is powered from a rail that rises slowly.

    endmenu

    menu "AS608 Protocol"

        config AS608_DEVICE_ADDRESS
            hex "Device address"
            default 0xffffffff
            help
                Default AS608 device address is 0xffffffff.

        config AS608_PASSWORD
            hex "Device password"
            default 0x00000000
            help
                Default AS608 password is 0x00000000.

        config AS608_WAIT_TIMEOUT_MS
            int "Finger wait timeout (ms, 0 waits forever)"
            default 15000
            range 0 120000
            help
                Timeout used by the demo commands while waiting for a finger.

        config AS608_REMOVE_TIMEOUT_MS
            int "Finger removal timeout (ms, 0 waits forever)"
            default 10000
            range 0 120000
            help
                Timeout used by enrollment while waiting for the finger to be removed.

    endmenu

endmenu
```
