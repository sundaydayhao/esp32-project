## chaobiao/main/Kconfig.projbuild
```kconfig
menu "Gas Meter Camera Push Configuration"

    config WIFI_SSID
        string "WiFi SSID"
        default "your_wifi_ssid"
        help
            SSID used by the device in station mode.

    config WIFI_PASSWORD
        string "WiFi password"
        default "your_wifi_password"
        help
            WiFi password used by the device in station mode.

    config WIFI_MAX_RETRY
        int "WiFi max retry count"
        default 10
        range 1 20
        help
            Maximum reconnection attempts before reporting a failure.

    config SMTP_SERVER
        string "SMTP server"
        default "smtp.163.com"
        help
            SMTP server hostname. The default assumes a NetEase 163 sender mailbox.

    config SMTP_PORT
        string "SMTP port"
        default "465"
        help
            SMTP port number. Use 465 for implicit TLS or 587 with STARTTLS enabled.

    config SMTP_USE_STARTTLS
        bool "Use STARTTLS"
        default n
        help
            Enable this if your SMTP provider expects a plain connection first,
            then upgrades to TLS with STARTTLS, which is common on port 587.

    config SMTP_SENDER_EMAIL
        string "SMTP sender email"
        default "zhanghao163mail@163.com"
        help
            The mailbox used to send email notifications.

    config SMTP_SENDER_AUTH_CODE
        string "SMTP sender auth code / app password"
        default ""
        help
            SMTP authorization code or app password for the sender mailbox.

    config SMTP_RECIPIENT_EMAIL
        string "SMTP recipient email"
        default "zhanghao163mail@163.com"
        help
            Recipient address for email notifications.

    config CAPTURE_INTERVAL_MINUTES
        int "Second capture target after startup (minutes)"
        default 1
        range 1 1440
        help
            Target time for the second and final capture, measured from device startup.

    config CAPTURE_INTERVAL_DEBUG_SECONDS
        int "Second capture target override (seconds, 0 disables)"
        default 30
        range 0 3600
        help
            Overrides the normal second-capture target during debugging. Set to
            0 to keep using the minute-based value above.

    config CAMERA_FRAME_SIZE
        int "Camera frame size"
        default 5
        range 0 13
        help
            0=96x96, 1=QQVGA, 2=QCIF, 3=HQVGA, 4=240x240,
            5=QVGA, 6=CIF, 7=HVGA, 8=VGA, 9=SVGA, 10=XGA,
            11=HD, 12=SXGA, 13=UXGA.
            These values follow this project's compatibility mapping and are
            translated to the current esp32-camera enum at runtime.

    config CAMERA_JPEG_QUALITY
        int "JPEG quality"
        default 12
        range 4 63
        help
            Lower values mean higher quality and larger images.

    menu "Flash LED"

        config FLASH_LED_ENABLE
            bool "Enable flash LED during capture"
            default y if CAMERA_BOARD_AI_THINKER_ESP32_CAM
            default n
            help
                Turns on the ESP32-CAM onboard flash LED only while capturing.

        config FLASH_LED_PIN
            int "Flash LED pin"
            default 4 if CAMERA_BOARD_AI_THINKER_ESP32_CAM
            default 4
            depends on FLASH_LED_ENABLE
            help
                AI-Thinker ESP32-CAM typically uses GPIO4 for the white flash LED.

        config FLASH_LED_ACTIVE_HIGH
            bool "Flash LED active high"
            default y
            depends on FLASH_LED_ENABLE
            help
                Enable if the LED turns on when the GPIO output is high.

        config FLASH_LED_PRECAPTURE_MS
            int "Flash LED pre-capture delay (ms)"
            default 120
            range 0 2000
            depends on FLASH_LED_ENABLE
            help
                Time to keep the flash on before calling the camera capture API.

        config FLASH_LED_SETTLE_FRAMES
            int "Flash LED settle frames"
            default 2
            range 0 5
            depends on FLASH_LED_ENABLE
            help
                Number of warmup frames to discard after the flash turns on so
                auto white balance and auto exposure can settle.

        config FLASH_LED_SETTLE_DELAY_MS
            int "Flash LED settle delay between warmup frames (ms)"
            default 80
            range 0 1000
            depends on FLASH_LED_ENABLE
            help
                Delay between discarded warmup frames while the flash is on.

        config FLASH_LED_POSTCAPTURE_MS
            int "Flash LED post-capture hold (ms)"
            default 0
            range 0 1000
            depends on FLASH_LED_ENABLE
            help
                Optional time to hold the flash on after capture completes.

    endmenu

    choice CAMERA_BOARD_PROFILE
        prompt "Camera board profile"
        default CAMERA_BOARD_AI_THINKER_ESP32_CAM
        help
            Pick a preset for common camera boards, or choose Custom and edit
            the camera pins below.

        config CAMERA_BOARD_AI_THINKER_ESP32_CAM
            bool "AI-Thinker ESP32-CAM / ESP32-CAM"

        config CAMERA_BOARD_CUSTOM
            bool "Custom"
    endchoice

    menu "Camera pin configuration"

        comment "Board profile selects defaults; values below remain editable."

        config CAM_PIN_PWDN
            int "PWDN pin (-1 if unused)"
            default 32 if CAMERA_BOARD_AI_THINKER_ESP32_CAM
            default 32

        config CAM_PIN_RESET
            int "RESET pin (-1 if unused)"
            default -1

        config CAM_PIN_XCLK
            int "XCLK pin"
            default 0 if CAMERA_BOARD_AI_THINKER_ESP32_CAM
            default 0

        config CAM_PIN_SIOD
            int "SIOD / SDA pin"
            default 26 if CAMERA_BOARD_AI_THINKER_ESP32_CAM
            default 26

        config CAM_PIN_SIOC
            int "SIOC / SCL pin"
            default 27 if CAMERA_BOARD_AI_THINKER_ESP32_CAM
            default 27

        config CAM_PIN_D7
            int "D7 pin"
            default 35 if CAMERA_BOARD_AI_THINKER_ESP32_CAM
            default 35

        config CAM_PIN_D6
            int "D6 pin"
            default 34 if CAMERA_BOARD_AI_THINKER_ESP32_CAM
            default 34

        config CAM_PIN_D5
            int "D5 pin"
            default 39 if CAMERA_BOARD_AI_THINKER_ESP32_CAM
            default 39

        config CAM_PIN_D4
            int "D4 pin"
            default 36 if CAMERA_BOARD_AI_THINKER_ESP32_CAM
            default 36

        config CAM_PIN_D3
            int "D3 pin"
            default 21 if CAMERA_BOARD_AI_THINKER_ESP32_CAM
            default 21

        config CAM_PIN_D2
            int "D2 pin"
            default 19 if CAMERA_BOARD_AI_THINKER_ESP32_CAM
            default 19

        config CAM_PIN_D1
            int "D1 pin"
            default 18 if CAMERA_BOARD_AI_THINKER_ESP32_CAM
            default 18

        config CAM_PIN_D0
            int "D0 pin"
            default 5 if CAMERA_BOARD_AI_THINKER_ESP32_CAM
            default 5

        config CAM_PIN_VSYNC
            int "VSYNC pin"
            default 25 if CAMERA_BOARD_AI_THINKER_ESP32_CAM
            default 25

        config CAM_PIN_HREF
            int "HREF pin"
            default 23 if CAMERA_BOARD_AI_THINKER_ESP32_CAM
            default 23

        config CAM_PIN_PCLK
            int "PCLK pin"
            default 22 if CAMERA_BOARD_AI_THINKER_ESP32_CAM
            default 22

    endmenu

endmenu
```

## chaobiao/sdkconfig.defaults
```kconfig
# Common defaults for all supported targets
CONFIG_ESP_WIFI_STATIC_RX_BUFFER_NUM=10
CONFIG_ESP_WIFI_DYNAMIC_RX_BUFFER_NUM=32
CONFIG_ESP_WIFI_AMPDU_TX_ENABLED=y
CONFIG_ESP_WIFI_AMPDU_RX_ENABLED=y

# HTTPS / mbedTLS
CONFIG_ESP_HTTP_CLIENT_ENABLE_HTTPS=y
CONFIG_MBEDTLS_CERTIFICATE_BUNDLE=y
CONFIG_MBEDTLS_CERTIFICATE_BUNDLE_DEFAULT_FULL=y
CONFIG_MBEDTLS_SSL_MAX_CONTENT_LEN=16384

# Task stack sizes
CONFIG_ESP_MAIN_TASK_STACK_SIZE=8192

# Logging
CONFIG_LOG_DEFAULT_LEVEL_INFO=y

# Email notification defaults
CONFIG_SMTP_SERVER="smtp.163.com"
CONFIG_SMTP_PORT="465"
CONFIG_SMTP_SENDER_EMAIL="zhanghao163mail@163.com"
CONFIG_SMTP_RECIPIENT_EMAIL="zhanghao163mail@163.com"
CONFIG_CAPTURE_INTERVAL_MINUTES=1
CONFIG_CAPTURE_INTERVAL_DEBUG_SECONDS=30

# Flash size
CONFIG_ESPTOOLPY_FLASHSIZE_4MB=y
CONFIG_PARTITION_TABLE_SINGLE_APP_LARGE=y

# Camera
CONFIG_CAMERA_TASK_STACK_SIZE=8192

# JPEG decoder compatibility for camera-generated JPEGs
# CONFIG_JD_USE_ROM is not set
CONFIG_JD_DEFAULT_HUFFMAN=y
```

## computer_motherboard_display/lcd12864/main/Kconfig.projbuild
```kconfig
menu "LCD12864 Clock Configuration"

    menu "WiFi Settings"
        config WIFI_SSID
            string "WiFi SSID"
            default "your_ssid"
            help
                WiFi 网络名称（SSID）

        config WIFI_PASSWORD
            string "WiFi Password"
            default "your_password"
            help
                WiFi 密码
    endmenu

    menu "LCD12864 Pin Configuration (8-bit Parallel)"
        comment "数据总线 D0~D7（8位并行）"

        config LCD_PIN_D0
            int "LCD D0 GPIO"
            default 12
            help
                LCD12864 数据总线 D0 引脚

        config LCD_PIN_D1
            int "LCD D1 GPIO"
            default 13
            help
                LCD12864 数据总线 D1 引脚

        config LCD_PIN_D2
            int "LCD D2 GPIO"
            default 14
            help
                LCD12864 数据总线 D2 引脚

        config LCD_PIN_D3
            int "LCD D3 GPIO"
            default 15
            help
                LCD12864 数据总线 D3 引脚

        config LCD_PIN_D4
            int "LCD D4 GPIO"
            default 16
            help
                LCD12864 数据总线 D4 引脚

        config LCD_PIN_D5
            int "LCD D5 GPIO"
            default 17
            help
                LCD12864 数据总线 D5 引脚

        config LCD_PIN_D6
            int "LCD D6 GPIO"
            default 18
            help
                LCD12864 数据总线 D6 引脚

        config LCD_PIN_D7
            int "LCD D7 GPIO"
            default 19
            help
                LCD12864 数据总线 D7 引脚

        comment "控制信号"

        config LCD_PIN_RS
            int "LCD RS GPIO"
            default 21
            help
                LCD12864 寄存器选择引脚（0=命令，1=数据）

        config LCD_PIN_E
            int "LCD E (Enable) GPIO"
            default 22
            help
                LCD12864 使能引脚（下降沿锁存数据）
                注意：RW 引脚请直接接 GND（始终写模式）

        config LCD_PIN_RST
            int "LCD RST GPIO"
            default 4
            help
                LCD12864 复位引脚（低电平有效）
    endmenu

    menu "Weather API Settings"
        config WEATHER_API_KEY
            string "QWeather API Key"
            default "your_qweather_api_key"
            help
                和风天气 API Key，在 https://dev.qweather.com 注册后获取。
                免费版每天 1000 次请求。

        config WEATHER_LOCATION_ID
            string "Location ID"
            default "101010100"
            help
                城市 Location ID，可在和风天气城市列表中查询。
                常用城市：
                  北京  101010100
                  上海  101020100
                  广州  101280101
                  深圳  101280601
                  杭州  101210101
                  成都  101270101

        config WEATHER_UPDATE_INTERVAL_MIN
            int "Weather update interval (minutes)"
            default 30
            range 5 1440
            help
                天气数据更新间隔（分钟），免费版建议 30 分钟以上。
    endmenu

    menu "NTP Settings"
        config NTP_SYNC_INTERVAL_MIN
            int "NTP re-sync interval (minutes)"
            default 60
            range 10 1440
            help
                NTP 时间重新同步间隔（分钟）。
    endmenu

endmenu
```
