## computer_motherboard_display/lcd1602/main/Kconfig.projbuild
```kconfig
menu "LCD1602 Clock Configuration"

    menu "WiFi Settings"
        config WIFI_SSID
            string "WiFi SSID"
            default "haoge"
            help
                WiFi 网络名称（SSID）

        config WIFI_PASSWORD
            string "WiFi Password"
            default "19901118"
            help
                WiFi 密码
    endmenu

    menu "LCD1602 Pin Configuration (8-bit Parallel)"
        comment "数据总线 D0~D7（8位并行）"

        config LCD_PIN_D0
            int "LCD D0 GPIO"
            default 12
            help
                LCD1602 数据总线 D0 引脚

        config LCD_PIN_D1
            int "LCD D1 GPIO"
            default 13
            help
                LCD1602 数据总线 D1 引脚

        config LCD_PIN_D2
            int "LCD D2 GPIO"
            default 14
            help
                LCD1602 数据总线 D2 引脚

        config LCD_PIN_D3
            int "LCD D3 GPIO"
            default 15
            help
                LCD1602 数据总线 D3 引脚

        config LCD_PIN_D4
            int "LCD D4 GPIO"
            default 16
            help
                LCD1602 数据总线 D4 引脚

        config LCD_PIN_D5
            int "LCD D5 GPIO"
            default 17
            help
                LCD1602 数据总线 D5 引脚

        config LCD_PIN_D6
            int "LCD D6 GPIO"
            default 18
            help
                LCD1602 数据总线 D6 引脚

        config LCD_PIN_D7
            int "LCD D7 GPIO"
            default 19
            help
                LCD1602 数据总线 D7 引脚

        comment "控制信号"

        config LCD_PIN_RS
            int "LCD RS GPIO"
            default 21
            help
                LCD1602 寄存器选择引脚（0=命令，1=数据）

        config LCD_PIN_E
            int "LCD E (Enable) GPIO"
            default 22
            help
                LCD1602 使能引脚（下降沿锁存数据）
                注意：RW 引脚请直接接 GND（始终写模式）

        config LCD_PIN_RST
            int "LCD RST GPIO"
            default 4
            help
                LCD1602 复位引脚（低电平有效）
    endmenu

    menu "Weather API Settings"
        config WEATHER_API_KEY
            string "QWeather API Key"
            default "04c81d5d4f3346a48d69b886c6c98cb0"
            help
                和风天气 API Key，在 https://dev.qweather.com 注册后获取。
                免费版每天 1000 次请求。

        config WEATHER_LOCATION_ID
            string "Location ID"
            default "101280601"
            help
                城市 Location ID，可在和风天气城市列表中查询。
                常用城市：
                  北京  101010100
                  上海  101020100
                  广州  101280101
                  深圳  101280601
                  杭州  101210101
                  成都  101270101

        config WEATHER_UPDATE_INTERVAL_MIN
            int "Weather update interval (minutes)"
            default 30
            range 5 1440
            help
                天气数据更新间隔（分钟），免费版建议 30 分钟以上。
    endmenu

    menu "NTP Settings"
        config NTP_SYNC_INTERVAL_MIN
            int "NTP re-sync interval (minutes)"
            default 60
            range 10 1440
            help
                NTP 时间重新同步间隔（分钟）。
    endmenu

    menu "Audio Announcement Settings"
        config AUDIO_I2S_BCLK_PIN
            int "Audio I2S BCLK GPIO"
            default 25
            help
                MAX98357A BCLK pin.

        config AUDIO_I2S_WS_PIN
            int "Audio I2S WS/LRCK GPIO"
            default 26
            help
                MAX98357A LRCK pin.

        config AUDIO_I2S_DOUT_PIN
            int "Audio I2S DOUT GPIO"
            default 27
            help
                MAX98357A DIN pin connected to ESP32 I2S data out.

        config AUDIO_ANNOUNCE_START_HOUR
            int "Hourly announce start hour"
            default 8
            range 0 23
            help
                Earliest hour for hourly voice announcement.

        config AUDIO_ANNOUNCE_END_HOUR
            int "Hourly announce end hour"
            default 20
            range 0 23
            help
                Latest hour for hourly voice announcement.
    endmenu

    menu "Indoor Sensor Settings"
        config DHT11_GPIO
            int "DHT11 data GPIO"
            default 23
            help
                DHT11 single-wire data pin. Use an external pull-up resistor.

        config DHT11_UPDATE_INTERVAL_SEC
            int "DHT11 update interval (seconds)"
            default 10
            range 2 3600
            help
                Interval between indoor temperature/humidity refreshes.
    endmenu

    menu "Display Settings"
        config DISPLAY_SCREEN_SWITCH_SEC
            int "Screen switch interval (seconds)"
            default 5
            range 2 60
            help
                Interval for alternating the two text screens.
    endmenu

endmenu
```

## computer_motherboard_display/lcd1602/sdkconfig.defaults
```kconfig
# ============================================================
# LCD1602 clock SDK defaults
# Source-compatible with both `esp32` and `esp32s3`.
# Select the actual chip before build:
#   idf.py set-target esp32
#   idf.py set-target esp32s3
# ============================================================

# CPU 240MHz
CONFIG_ESP_DEFAULT_CPU_FREQ_MHZ_240=y

# Flash 4MB
CONFIG_ESPTOOLPY_FLASHSIZE_4MB=y
CONFIG_ESPTOOLPY_FLASHFREQ_80M=y
CONFIG_ESPTOOLPY_FLASHMODE_DIO=y

# FreeRTOS tick 1000Hz
CONFIG_FREERTOS_HZ=1000

# 日志级别
CONFIG_LOG_DEFAULT_LEVEL_INFO=y

# SNTP
CONFIG_LWIP_SNTP_MAX_SERVERS=3

# HTTP Client
CONFIG_ESP_HTTP_CLIENT_ENABLE_HTTPS=y

# mbedTLS
CONFIG_MBEDTLS_CERTIFICATE_BUNDLE=y
CONFIG_MBEDTLS_CERTIFICATE_BUNDLE_DEFAULT_FULL=y

# WiFi
CONFIG_ESP_WIFI_STATIC_RX_BUFFER_NUM=10
CONFIG_ESP_WIFI_DYNAMIC_RX_BUFFER_NUM=32
CONFIG_ESP_WIFI_DYNAMIC_TX_BUFFER=y

# 堆栈大小
CONFIG_ESP_MAIN_TASK_STACK_SIZE=4096
```

## computer_motherboard_display/rgb-lcd-nt35510/main/Kconfig.projbuild
```kconfig
menu "Desk Clock Hardware"

    config DESK_CLOCK_NT35510_H_RES
        int "Horizontal resolution"
        range 1 2048
        default 800

    config DESK_CLOCK_NT35510_V_RES
        int "Vertical resolution"
        range 1 2048
        default 480

    config DESK_CLOCK_NT35510_PIXEL_CLOCK_HZ
        int "I80 pixel clock (Hz)"
        range 1 40000000
        default 8000000
        help
            Start with a conservative clock for generic NT35510 boards.
            Higher values can improve throughput, but often introduce
            color artifacts or ghosting on long 16-bit buses.

    config DESK_CLOCK_NT35510_DRAW_BUF_LINES
        int "LVGL partial buffer lines"
        range 1 480
        default 40
        help
            Number of lines in each LVGL draw buffer for the NT35510 path.
            Higher values improve throughput but consume more PSRAM.

    choice DESK_CLOCK_NT35510_I80_BUS_WIDTH_CHOICE
        prompt "I80 bus width"
        default DESK_CLOCK_NT35510_I80_BUS_WIDTH_16

        config DESK_CLOCK_NT35510_I80_BUS_WIDTH_8
            bool "8-bit"

        config DESK_CLOCK_NT35510_I80_BUS_WIDTH_16
            bool "16-bit"
    endchoice

    config DESK_CLOCK_NT35510_I80_BUS_WIDTH
        int
        default 8 if DESK_CLOCK_NT35510_I80_BUS_WIDTH_8
        default 16 if DESK_CLOCK_NT35510_I80_BUS_WIDTH_16

    choice DESK_CLOCK_NT35510_COLOR_ORDER
        prompt "Panel color order"
        default DESK_CLOCK_NT35510_COLOR_ORDER_BGR

        config DESK_CLOCK_NT35510_COLOR_ORDER_RGB
            bool "RGB"

        config DESK_CLOCK_NT35510_COLOR_ORDER_BGR
            bool "BGR"
    endchoice

    config DESK_CLOCK_NT35510_SWAP_XY
        bool "Swap X/Y"
        default y

    config DESK_CLOCK_NT35510_MIRROR_X
        bool "Mirror X"
        default y

    config DESK_CLOCK_NT35510_MIRROR_Y
        bool "Mirror Y"
        default n

    config DESK_CLOCK_NT35510_INVERT_COLOR
        bool "Invert color"
        default n

    config DESK_CLOCK_NT35510_SWAP_RGB565_BYTES
        bool "Swap RGB565 bytes before flush"
        default y if DESK_CLOCK_NT35510_I80_BUS_WIDTH_8
        default n if DESK_CLOCK_NT35510_I80_BUS_WIDTH_16
        help
            Keep this enabled for panels that expect big-endian RGB565
            color payloads on the I80 bus. Most 16-bit parallel buses
            should leave this disabled.

    config DESK_CLOCK_NT35510_PIN_WR
        int "WR pin"
        range -1 48
        default -1

    config DESK_CLOCK_NT35510_PIN_CS
        int "CS pin"
        range -1 48
        default -1

    config DESK_CLOCK_NT35510_PIN_DC
        int "DC pin"
        range -1 48
        default -1

    config DESK_CLOCK_NT35510_PIN_RST
        int "RST pin"
        range -1 48
        default -1

    config DESK_CLOCK_NT35510_PIN_BK_LIGHT
        int "Backlight pin"
        range -1 48
        default -1

    config DESK_CLOCK_NT35510_PIN_POWER
        int "Panel power-enable pin"
        range -1 48
        default -1

    config DESK_CLOCK_NT35510_BK_LIGHT_ACTIVE_HIGH
        bool "Backlight active high"
        default y

    config DESK_CLOCK_NT35510_POWER_ACTIVE_HIGH
        bool "Panel power-enable active high"
        default y

    config DESK_CLOCK_NT35510_PIN_D0
        int "D0 pin"
        range -1 48
        default -1

    config DESK_CLOCK_NT35510_PIN_D1
        int "D1 pin"
        range -1 48
        default -1

    config DESK_CLOCK_NT35510_PIN_D2
        int "D2 pin"
        range -1 48
        default -1

    config DESK_CLOCK_NT35510_PIN_D3
        int "D3 pin"
        range -1 48
        default -1

    config DESK_CLOCK_NT35510_PIN_D4
        int "D4 pin"
        range -1 48
        default -1

    config DESK_CLOCK_NT35510_PIN_D5
        int "D5 pin"
        range -1 48
        default -1

    config DESK_CLOCK_NT35510_PIN_D6
        int "D6 pin"
        range -1 48
        default -1

    config DESK_CLOCK_NT35510_PIN_D7
        int "D7 pin"
        range -1 48
        default -1

    if DESK_CLOCK_NT35510_I80_BUS_WIDTH_16

        config DESK_CLOCK_NT35510_PIN_D8
            int "D8 pin"
            range -1 48
            default -1

        config DESK_CLOCK_NT35510_PIN_D9
            int "D9 pin"
            range -1 48
            default -1

        config DESK_CLOCK_NT35510_PIN_D10
            int "D10 pin"
            range -1 48
            default -1

        config DESK_CLOCK_NT35510_PIN_D11
            int "D11 pin"
            range -1 48
            default -1

        config DESK_CLOCK_NT35510_PIN_D12
            int "D12 pin"
            range -1 48
            default -1

        config DESK_CLOCK_NT35510_PIN_D13
            int "D13 pin"
            range -1 48
            default -1

        config DESK_CLOCK_NT35510_PIN_D14
            int "D14 pin"
            range -1 48
            default -1

        config DESK_CLOCK_NT35510_PIN_D15
            int "D15 pin"
            range -1 48
            default -1

    endif

endmenu
```

## computer_motherboard_display/rgb-lcd-nt35510/sdkconfig.defaults
```kconfig
# ============================================================
# ESP32-S3 desk clock SDK config
# ============================================================

CONFIG_IDF_TARGET="esp32s3"

# CPU 240MHz
CONFIG_ESP_DEFAULT_CPU_FREQ_MHZ_240=y
CONFIG_ESP_DEFAULT_CPU_FREQ_MHZ=240

# PSRAM
CONFIG_SPIRAM=y
CONFIG_SPIRAM_MODE_OCT=y
CONFIG_SPIRAM_SPEED_80M=y
CONFIG_SPIRAM_BOOT_INIT=y
CONFIG_SPIRAM_USE_MALLOC=y
CONFIG_SPIRAM_MALLOC_ALWAYSINTERNAL=16384
CONFIG_SPIRAM_MALLOC_RESERVE_INTERNAL=32768

# Flash 16MB
CONFIG_ESPTOOLPY_FLASHSIZE_16MB=y
CONFIG_ESPTOOLPY_FLASHSIZE="16MB"
CONFIG_ESPTOOLPY_FLASHFREQ_80M=y
CONFIG_ESPTOOLPY_FLASHMODE_QIO=y

# FreeRTOS
CONFIG_FREERTOS_HZ=1000
CONFIG_FREERTOS_UNICORE=n

# WiFi
CONFIG_ESP_WIFI_STATIC_RX_BUFFER_NUM=10
CONFIG_ESP_WIFI_DYNAMIC_RX_BUFFER_NUM=32

# HTTP Client
CONFIG_ESP_HTTP_CLIENT_ENABLE_HTTPS=y

# ESP-TLS
CONFIG_ESP_TLS_INSECURE=y
CONFIG_ESP_TLS_SKIP_SERVER_CERT_VERIFY=y

# mbedTLS
# Use software MPI for RSA certificate verification stability.
# CONFIG_MBEDTLS_HARDWARE_MPI is not set
# CONFIG_MBEDTLS_MPI_USE_INTERRUPT is not set
CONFIG_MBEDTLS_EXTERNAL_MEM_ALLOC=y
# CONFIG_MBEDTLS_INTERNAL_MEM_ALLOC is not set
CONFIG_MBEDTLS_ASYMMETRIC_CONTENT_LEN=y
CONFIG_MBEDTLS_SSL_IN_CONTENT_LEN=4096
CONFIG_MBEDTLS_SSL_OUT_CONTENT_LEN=2048
CONFIG_MBEDTLS_DYNAMIC_BUFFER=y
# CONFIG_MBEDTLS_SSL_KEEP_PEER_CERTIFICATE is not set

# SNTP
CONFIG_LWIP_SNTP_MAX_SERVERS=3

# NT35510 I80 hardware profile
CONFIG_DESK_CLOCK_NT35510_H_RES=800
CONFIG_DESK_CLOCK_NT35510_V_RES=480
CONFIG_DESK_CLOCK_NT35510_PIXEL_CLOCK_HZ=8000000
CONFIG_DESK_CLOCK_NT35510_DRAW_BUF_LINES=40
# CONFIG_DESK_CLOCK_NT35510_I80_BUS_WIDTH_8 is not set
CONFIG_DESK_CLOCK_NT35510_I80_BUS_WIDTH_16=y
CONFIG_DESK_CLOCK_NT35510_I80_BUS_WIDTH=16
CONFIG_DESK_CLOCK_NT35510_COLOR_ORDER_RGB=y
# CONFIG_DESK_CLOCK_NT35510_COLOR_ORDER_BGR is not set
CONFIG_DESK_CLOCK_NT35510_SWAP_XY=y
CONFIG_DESK_CLOCK_NT35510_MIRROR_X=y
# CONFIG_DESK_CLOCK_NT35510_MIRROR_Y is not set
# CONFIG_DESK_CLOCK_NT35510_INVERT_COLOR is not set
# CONFIG_DESK_CLOCK_NT35510_SWAP_RGB565_BYTES is not set
CONFIG_DESK_CLOCK_NT35510_BK_LIGHT_ACTIVE_HIGH=y
CONFIG_DESK_CLOCK_NT35510_POWER_ACTIVE_HIGH=y
CONFIG_DESK_CLOCK_NT35510_PIN_WR=18
CONFIG_DESK_CLOCK_NT35510_PIN_CS=17
CONFIG_DESK_CLOCK_NT35510_PIN_DC=16
CONFIG_DESK_CLOCK_NT35510_PIN_RST=20
CONFIG_DESK_CLOCK_NT35510_PIN_BK_LIGHT=38
CONFIG_DESK_CLOCK_NT35510_PIN_POWER=19
CONFIG_DESK_CLOCK_NT35510_PIN_D0=0
CONFIG_DESK_CLOCK_NT35510_PIN_D1=1
CONFIG_DESK_CLOCK_NT35510_PIN_D2=2
CONFIG_DESK_CLOCK_NT35510_PIN_D3=3
CONFIG_DESK_CLOCK_NT35510_PIN_D4=4
CONFIG_DESK_CLOCK_NT35510_PIN_D5=5
CONFIG_DESK_CLOCK_NT35510_PIN_D6=6
CONFIG_DESK_CLOCK_NT35510_PIN_D7=7
CONFIG_DESK_CLOCK_NT35510_PIN_D8=8
CONFIG_DESK_CLOCK_NT35510_PIN_D9=9
CONFIG_DESK_CLOCK_NT35510_PIN_D10=10
CONFIG_DESK_CLOCK_NT35510_PIN_D11=11
CONFIG_DESK_CLOCK_NT35510_PIN_D12=12
CONFIG_DESK_CLOCK_NT35510_PIN_D13=13
CONFIG_DESK_CLOCK_NT35510_PIN_D14=14
CONFIG_DESK_CLOCK_NT35510_PIN_D15=15

# Logging
CONFIG_LOG_DEFAULT_LEVEL_INFO=y
CONFIG_LOG_DEFAULT_LEVEL=3

# Task watchdog
CONFIG_ESP_TASK_WDT_TIMEOUT_S=30
CONFIG_ESP_TASK_WDT_CHECK_IDLE_TASK_CPU0=n
CONFIG_ESP_TASK_WDT_CHECK_IDLE_TASK_CPU1=n

# Main task
CONFIG_ESP_MAIN_TASK_STACK_SIZE=8192

# SPIFFS
CONFIG_SPIFFS_MAX_PARTITIONS=1

# Partition table
# CONFIG_PARTITION_TABLE_SINGLE_APP is not set
CONFIG_PARTITION_TABLE_CUSTOM=y
CONFIG_PARTITION_TABLE_CUSTOM_FILENAME="partitions.csv"

# LVGL
CONFIG_LV_FONT_MONTSERRAT_14=y
CONFIG_LV_FONT_SIMSUN_16_CJK=y
CONFIG_LV_FONT_MONTSERRAT_18=y
CONFIG_LV_FONT_MONTSERRAT_32=y
CONFIG_LV_FONT_MONTSERRAT_48=y
CONFIG_LV_FONT_DEFAULT_MONTSERRAT_14=y
# CONFIG_LV_BUILD_EXAMPLES is not set
# CONFIG_LV_USE_ANIMIMG is not set
# CONFIG_LV_USE_ARC is not set
# CONFIG_LV_USE_BAR is not set
# CONFIG_LV_USE_BUTTON is not set
# CONFIG_LV_USE_BUTTONMATRIX is not set
# CONFIG_LV_USE_CALENDAR is not set
# CONFIG_LV_USE_CANVAS is not set
# CONFIG_LV_USE_CHART is not set
# CONFIG_LV_USE_CHECKBOX is not set
# CONFIG_LV_USE_DROPDOWN is not set
# CONFIG_LV_USE_IMAGE is not set
# CONFIG_LV_USE_IMAGEBUTTON is not set
# CONFIG_LV_USE_KEYBOARD is not set
# CONFIG_LV_USE_LED is not set
# CONFIG_LV_USE_LINE is not set
# CONFIG_LV_USE_LIST is not set
# CONFIG_LV_USE_MENU is not set
# CONFIG_LV_USE_MSGBOX is not set
# CONFIG_LV_USE_ROLLER is not set
# CONFIG_LV_USE_SCALE is not set
# CONFIG_LV_USE_SLIDER is not set
# CONFIG_LV_USE_SPAN is not set
# CONFIG_LV_USE_SPINBOX is not set
# CONFIG_LV_USE_SPINNER is not set
# CONFIG_LV_USE_SWITCH is not set
# CONFIG_LV_USE_TEXTAREA is not set
# CONFIG_LV_USE_TABLE is not set
# CONFIG_LV_USE_TABVIEW is not set
# CONFIG_LV_USE_TILEVIEW is not set
# CONFIG_LV_USE_WIN is not set
# CONFIG_LV_USE_THEME_SIMPLE is not set
# CONFIG_LV_USE_GRID is not set
# CONFIG_LV_USE_OBSERVER is not set
```
