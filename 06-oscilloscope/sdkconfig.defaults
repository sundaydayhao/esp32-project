## delivery-box/sdkconfig.defaults
```kconfig
# ESP32-S3 Smart Locker - Default SDK Configuration

# Target
CONFIG_IDF_TARGET="esp32s3"

# Partition table
CONFIG_PARTITION_TABLE_CUSTOM=y
CONFIG_PARTITION_TABLE_CUSTOM_FILENAME="partitions.csv"

# FreeRTOS
CONFIG_FREERTOS_HZ=1000
CONFIG_FREERTOS_UNICORE=n

# Main task stack size
CONFIG_ESP_MAIN_TASK_STACK_SIZE=8192

# WiFi
CONFIG_ESP_WIFI_STATIC_RX_BUFFER_NUM=10
CONFIG_ESP_WIFI_DYNAMIC_RX_BUFFER_NUM=32
CONFIG_ESP_WIFI_TX_BUFFER_TYPE_DYNAMIC=y

# Log level
CONFIG_LOG_DEFAULT_LEVEL_INFO=y

# NVS
CONFIG_NVS_ENCRYPTION=n

# HTTP Server
CONFIG_HTTPD_MAX_REQ_HDR_LEN=1024
CONFIG_HTTPD_MAX_URI_LEN=512

# LWIP
CONFIG_LWIP_MAX_SOCKETS=16

# ESP32-S3 specific
CONFIG_ESP32S3_DEFAULT_CPU_FREQ_240=y
CONFIG_ESPTOOLPY_FLASHSIZE_4MB=y
```

## desk-clock/weixue-touch-lcd-7/sdkconfig.defaults
```kconfig
# ============================================================
# ESP32-S3 桌面时钟 SDK 配置
# ============================================================

CONFIG_IDF_TARGET="esp32s3"

# CPU 240MHz
CONFIG_ESP_DEFAULT_CPU_FREQ_MHZ_240=y
CONFIG_ESP_DEFAULT_CPU_FREQ_MHZ=240

# PSRAM (帧缓冲区必须)
CONFIG_SPIRAM=y
CONFIG_SPIRAM_MODE_OCT=y
CONFIG_SPIRAM_SPEED_80M=y
CONFIG_SPIRAM_BOOT_INIT=y
CONFIG_SPIRAM_USE_MALLOC=y
CONFIG_SPIRAM_MALLOC_ALWAYSINTERNAL=16384
CONFIG_SPIRAM_MALLOC_RESERVE_INTERNAL=32768

# Flash 16MB
CONFIG_ESPTOOLPY_FLASHSIZE_16MB=y
CONFIG_ESPTOOLPY_FLASHSIZE="16MB"
CONFIG_ESPTOOLPY_FLASHFREQ_80M=y
CONFIG_ESPTOOLPY_FLASHMODE_QIO=y

# FreeRTOS
CONFIG_FREERTOS_HZ=1000
CONFIG_FREERTOS_UNICORE=n

# WiFi
CONFIG_ESP_WIFI_STATIC_RX_BUFFER_NUM=10
CONFIG_ESP_WIFI_DYNAMIC_RX_BUFFER_NUM=32

# HTTP Client
CONFIG_ESP_HTTP_CLIENT_ENABLE_HTTPS=y

# ESP-TLS
CONFIG_ESP_TLS_INSECURE=y
CONFIG_ESP_TLS_SKIP_SERVER_CERT_VERIFY=y

# mbedTLS
# Use software MPI for RSA certificate verification stability.
# CONFIG_MBEDTLS_HARDWARE_MPI is not set
# CONFIG_MBEDTLS_MPI_USE_INTERRUPT is not set

# SNTP
CONFIG_LWIP_SNTP_MAX_SERVERS=3

# LCD DMA
# LVGL's flush-ready callback runs from the RGB ISR path and is not IRAM-safe.
# Keep the RGB panel in the default mode unless the callback chain is moved to IRAM.
# CONFIG_LCD_RGB_ISR_IRAM_SAFE is not set

# 日志
CONFIG_LOG_DEFAULT_LEVEL_INFO=y
CONFIG_LOG_DEFAULT_LEVEL=3

# 看门狗
CONFIG_ESP_TASK_WDT_TIMEOUT_S=30
CONFIG_ESP_TASK_WDT_CHECK_IDLE_TASK_CPU0=n
CONFIG_ESP_TASK_WDT_CHECK_IDLE_TASK_CPU1=n

# 主任务栈
CONFIG_ESP_MAIN_TASK_STACK_SIZE=8192

# SPIFFS
CONFIG_SPIFFS_MAX_PARTITIONS=1

# Partition table
# CONFIG_PARTITION_TABLE_SINGLE_APP is not set
CONFIG_PARTITION_TABLE_CUSTOM=y
CONFIG_PARTITION_TABLE_CUSTOM_FILENAME="partitions.csv"

# LVGL
CONFIG_LV_USE_CLIB_MALLOC=y
CONFIG_LV_FONT_MONTSERRAT_14=y
CONFIG_LV_FONT_SIMSUN_16_CJK=y
CONFIG_LV_FONT_MONTSERRAT_18=y
CONFIG_LV_FONT_MONTSERRAT_32=y
CONFIG_LV_FONT_MONTSERRAT_48=y
CONFIG_LV_FONT_DEFAULT_MONTSERRAT_14=y
CONFIG_LV_USE_FONT_COMPRESSED=y
CONFIG_LV_FS_DEFAULT_DRIVE_LETTER=65
CONFIG_LV_USE_FS_STDIO=y
CONFIG_LV_FS_STDIO_LETTER=65
# CONFIG_LV_BUILD_EXAMPLES is not set
# CONFIG_LV_USE_ANIMIMG is not set
# CONFIG_LV_USE_ARC is not set
CONFIG_LV_USE_BAR=y
CONFIG_LV_USE_BUTTON=y
# CONFIG_LV_USE_BUTTONMATRIX is not set
# CONFIG_LV_USE_CALENDAR is not set
# CONFIG_LV_USE_CANVAS is not set
# CONFIG_LV_USE_CHART is not set
# CONFIG_LV_USE_CHECKBOX is not set
# CONFIG_LV_USE_DROPDOWN is not set
# CONFIG_LV_USE_IMAGE is not set
# CONFIG_LV_USE_IMAGEBUTTON is not set
# CONFIG_LV_USE_KEYBOARD is not set
# CONFIG_LV_USE_LED is not set
# CONFIG_LV_USE_LINE is not set
# CONFIG_LV_USE_LIST is not set
# CONFIG_LV_USE_MENU is not set
# CONFIG_LV_USE_MSGBOX is not set
# CONFIG_LV_USE_ROLLER is not set
# CONFIG_LV_USE_SCALE is not set
CONFIG_LV_USE_SLIDER=y
# CONFIG_LV_USE_SPAN is not set
# CONFIG_LV_USE_SPINBOX is not set
# CONFIG_LV_USE_SPINNER is not set
# CONFIG_LV_USE_SWITCH is not set
# CONFIG_LV_USE_TEXTAREA is not set
# CONFIG_LV_USE_TABLE is not set
# CONFIG_LV_USE_TABVIEW is not set
# CONFIG_LV_USE_TILEVIEW is not set
# CONFIG_LV_USE_WIN is not set
# CONFIG_LV_USE_THEME_SIMPLE is not set
# CONFIG_LV_USE_GRID is not set
# CONFIG_LV_USE_OBSERVER is not set
```

## display_controller_a/sdkconfig.defaults
```kconfig
# ESP32-S3 目标
CONFIG_IDF_TARGET="esp32s3"

# Flash 配置
CONFIG_ESPTOOLPY_FLASHSIZE_16MB=y
CONFIG_PARTITION_TABLE_CUSTOM=y
CONFIG_PARTITION_TABLE_CUSTOM_FILENAME="partitions.csv"

# PSRAM 配置（ESP32-S3-WROOM-1 带 8MB PSRAM）
CONFIG_SPIRAM=y
CONFIG_SPIRAM_MODE_OCT=y
CONFIG_SPIRAM_SPEED_80M=y
CONFIG_SPIRAM_USE_MALLOC=y
CONFIG_SPIRAM_MALLOC_ALWAYSINTERNAL=16384

# SPI 驱动
CONFIG_SPI_MASTER_IN_IRAM=y

# HTTP 服务器
CONFIG_HTTPD_MAX_REQ_HDR_LEN=1024
CONFIG_HTTPD_MAX_URI_LEN=512
CONFIG_HTTPD_WS_SUPPORT=n

# mDNS
CONFIG_MDNS_MAX_SERVICES=5

# NVS
CONFIG_NVS_ASSERT_ERROR_CHECK=n

# 日志级别
CONFIG_LOG_DEFAULT_LEVEL_INFO=y

# FreeRTOS
CONFIG_FREERTOS_HZ=1000
CONFIG_FREERTOS_UNICORE=n

# 任务栈大小
CONFIG_ESP_MAIN_TASK_STACK_SIZE=8192

# WiFi
CONFIG_ESP_WIFI_STATIC_RX_BUFFER_NUM=10
CONFIG_ESP_WIFI_DYNAMIC_RX_BUFFER_NUM=32
```

## doorman/main/Kconfig.projbuild
```kconfig
menu "门卫系统配置 (Doorman Configuration)"

    menu "WiFi 设置"
        config DOORMAN_WIFI_SSID
            string "家庭 WiFi SSID"
            default "MyHomeWiFi"
            help
                连接的家庭 WiFi 网络名称。

        config DOORMAN_WIFI_PASSWORD
            string "家庭 WiFi 密码"
            default ""
            help
                家庭 WiFi 网络密码。

        config DOORMAN_WIFI_MAX_RETRY
            int "WiFi 最大重连次数"
            default 10
            help
                WiFi 断线后最大重连尝试次数。
    endmenu

    menu "微信通知设置"
        config DOORMAN_SERVERCHAN_KEY
            string "Server酱 SendKey"
            default ""
            help
                Server酱 (sct.ftqq.com) 的 SendKey，用于推送微信通知。
                请前往 https://sct.ftqq.com 注册获取。

        config DOORMAN_WECHAT_NOTIFY_TITLE
            string "微信通知标题"
            default "门口有动静！"
            help
                发送到微信的通知标题。

        config DOORMAN_ENABLE_WECHAT_NOTIFY
            bool "启用微信通知"
            default y
            help
                是否启用微信推送通知。
    endmenu

    menu "摄像头引脚配置"
        config DOORMAN_CAM_PIN_PWDN
            int "摄像头 PWDN 引脚"
            default -1
            help
                摄像头电源控制引脚，-1 表示不使用。

        config DOORMAN_CAM_PIN_RESET
            int "摄像头 RESET 引脚"
            default -1
            help
                摄像头复位引脚，-1 表示不使用。

        config DOORMAN_CAM_PIN_XCLK
            int "摄像头 XCLK 引脚"
            default 15
            help
                摄像头时钟输入引脚。

        config DOORMAN_CAM_PIN_SIOD
            int "摄像头 SIOD (SDA) 引脚"
            default 4
            help
                摄像头 I2C 数据引脚。

        config DOORMAN_CAM_PIN_SIOC
            int "摄像头 SIOC (SCL) 引脚"
            default 5
            help
                摄像头 I2C 时钟引脚。

        config DOORMAN_CAM_PIN_D7
            int "摄像头 D7 引脚"
            default 16
        config DOORMAN_CAM_PIN_D6
            int "摄像头 D6 引脚"
            default 17
        config DOORMAN_CAM_PIN_D5
            int "摄像头 D5 引脚"
            default 18
        config DOORMAN_CAM_PIN_D4
            int "摄像头 D4 引脚"
            default 12
        config DOORMAN_CAM_PIN_D3
            int "摄像头 D3 引脚"
            default 10
        config DOORMAN_CAM_PIN_D2
            int "摄像头 D2 引脚"
            default 8
        config DOORMAN_CAM_PIN_D1
            int "摄像头 D1 引脚"
            default 9
        config DOORMAN_CAM_PIN_D0
            int "摄像头 D0 引脚"
            default 11

        config DOORMAN_CAM_PIN_VSYNC
            int "摄像头 VSYNC 引脚"
            default 6
        config DOORMAN_CAM_PIN_HREF
            int "摄像头 HREF 引脚"
            default 7
        config DOORMAN_CAM_PIN_PCLK
            int "摄像头 PCLK 引脚"
            default 13

        config DOORMAN_CAM_XCLK_FREQ_HZ
            int "摄像头 XCLK 频率 (Hz)"
            default 20000000
            help
                摄像头 XCLK 时钟频率，通常为 20MHz。
    endmenu

    menu "运动检测设置"
        config DOORMAN_PIR_GPIO
            int "PIR 传感器 GPIO 引脚"
            default 2
            help
                连接 PIR 人体红外传感器的 GPIO 引脚。

        config DOORMAN_LED_GPIO
            int "状态 LED GPIO 引脚"
            default 48
            help
                状态指示 LED 的 GPIO 引脚（ESP32-S3 内置 LED 通常为 48）。

        config DOORMAN_MOTION_COOLDOWN_SEC
            int "运动检测冷却时间 (秒)"
            default 30
            range 5 300
            help
                两次运动检测事件之间的最小间隔时间（秒）。

        config DOORMAN_ENABLE_SW_MOTION_DETECT
            bool "启用软件运动检测（帧差法）"
            default y
            help
                使用摄像头帧差算法进行软件运动检测，可与 PIR 传感器配合使用。

        config DOORMAN_SW_MOTION_THRESHOLD
            int "软件运动检测阈值 (%)"
            default 5
            range 1 50
            help
                帧差超过此百分比时触发运动检测。
    endmenu

    menu "快递检测设置"
        config DOORMAN_ENABLE_PACKAGE_DETECTION
            bool "启用快递检测"
            default y
            help
                检测门口是否有快递包裹留下。

        config DOORMAN_PACKAGE_DETECT_DELAY_SEC
            int "快递检测延迟 (秒)"
            default 60
            range 10 300
            help
                运动停止后等待多少秒再检测是否有快递留下。

        config DOORMAN_PACKAGE_DIFF_THRESHOLD
            int "快递检测差异阈值 (%)"
            default 10
            range 1 50
            help
                与背景帧相比，差异超过此百分比时认为有快递留下。
    endmenu

    menu "图像服务器设置"
        config DOORMAN_HTTP_SERVER_PORT
            int "HTTP 图像服务器端口"
            default 80
            range 1 65535
            help
                本地 HTTP 图像服务器监听端口。

        config DOORMAN_MAX_STORED_IMAGES
            int "最大存储图像数量"
            default 10
            range 1 50
            help
                内存中保存的最近图像数量。
    endmenu

endmenu
```

## doorman/sdkconfig.defaults
```kconfig
# ESP32-S3 Doorman - Default SDK Configuration

# Target
CONFIG_IDF_TARGET="esp32s3"

# Enable PSRAM (required for camera frame buffer)
CONFIG_ESP32S3_SPIRAM_SUPPORT=y
CONFIG_SPIRAM=y
CONFIG_SPIRAM_MODE_OCT=y
CONFIG_SPIRAM_SPEED_80M=y
CONFIG_SPIRAM_USE_MALLOC=y
CONFIG_SPIRAM_MALLOC_ALWAYSINTERNAL=16384

# Camera requires large stack
CONFIG_ESP_MAIN_TASK_STACK_SIZE=8192

# WiFi
CONFIG_ESP_WIFI_STATIC_RX_BUFFER_NUM=10
CONFIG_ESP_WIFI_DYNAMIC_RX_BUFFER_NUM=32
CONFIG_ESP_WIFI_TX_BUFFER_TYPE_DYNAMIC=y

# HTTP Server
CONFIG_HTTPD_MAX_REQ_HDR_LEN=1024
CONFIG_HTTPD_MAX_URI_LEN=512

# Increase TCP/IP stack
CONFIG_LWIP_TCP_SND_BUF_DEFAULT=65535
CONFIG_LWIP_TCP_WND_DEFAULT=65535
CONFIG_LWIP_TCP_RECVMBOX_SIZE=32
CONFIG_LWIP_UDP_RECVMBOX_SIZE=16
CONFIG_LWIP_TCPIP_RECVMBOX_SIZE=32

# TLS/HTTPS support
CONFIG_ESP_TLS_USING_MBEDTLS=y
CONFIG_MBEDTLS_CERTIFICATE_BUNDLE=y
CONFIG_MBEDTLS_CERTIFICATE_BUNDLE_DEFAULT_FULL=y

# Logging
CONFIG_LOG_DEFAULT_LEVEL_INFO=y

# Flash size 8MB
CONFIG_ESPTOOLPY_FLASHSIZE_8MB=y
CONFIG_PARTITION_TABLE_CUSTOM=y
CONFIG_PARTITION_TABLE_CUSTOM_FILENAME="partitions.csv"

# FreeRTOS
CONFIG_FREERTOS_HZ=1000
```

## human-fall-off/sdkconfig.defaults
```kconfig
# ESP32-S3 人体跌倒检测系统配置

# WiFi 配置
CONFIG_WIFI_SSID="YourWiFiSSID"
CONFIG_WIFI_PASSWORD="YourWiFiPassword"
CONFIG_WIFI_CHANNEL=6

# ESP32-S3 配置
CONFIG_IDF_TARGET="esp32s3"
CONFIG_ESPTOOLPY_FLASHSIZE_4MB=y

# FreeRTOS 配置
CONFIG_FREERTOS_HZ=1000
CONFIG_FREERTOS_UNICORE=n

# WiFi 驱动配置
CONFIG_ESP_WIFI_STATIC_RX_BUFFER_NUM=10
CONFIG_ESP_WIFI_DYNAMIC_RX_BUFFER_NUM=32
CONFIG_ESP_WIFI_DYNAMIC_TX_BUFFER_NUM=32
CONFIG_ESP_WIFI_AMPDU_TX_ENABLED=y
CONFIG_ESP_WIFI_AMPDU_RX_ENABLED=y
CONFIG_ESP_WIFI_ENABLE_WPA3_SAE=y

# CSI 配置
CONFIG_ESP_WIFI_CSI_ENABLED=y

# 日志配置
CONFIG_LOG_DEFAULT_LEVEL_INFO=y
CONFIG_LOG_MAXIMUM_LEVEL_VERBOSE=y

# UART 配置
CONFIG_ESP_CONSOLE_UART_DEFAULT=y
CONFIG_ESP_CONSOLE_UART_NUM=0
CONFIG_ESP_CONSOLE_UART_BAUDRATE=115200

# 内存配置
CONFIG_ESP_SYSTEM_EVENT_TASK_STACK_SIZE=4096
CONFIG_ESP_MAIN_TASK_STACK_SIZE=8192

# PSRAM 配置 (如果硬件支持)
CONFIG_SPIRAM=y
CONFIG_SPIRAM_MODE_OCT=y
CONFIG_SPIRAM_SPEED_80M=y
CONFIG_SPIRAM_USE_MALLOC=y

# 编译器优化
CONFIG_COMPILER_OPTIMIZATION_PERF=y
```
