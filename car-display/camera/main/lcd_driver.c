/**
 * @file lcd_driver.c
 * @brief SPI LCD 驱动 (兼容 ST7789 / ILI9341)
 *
 * 使用 ESP-IDF esp_lcd 组件驱动 SPI 接口 LCD 屏幕。
 * 支持 320x240 分辨率，RGB565 色彩格式。
 */

#include "lcd_driver.h"
#include "esp_lcd_panel_io.h"
#include "esp_lcd_panel_vendor.h"
#include "esp_lcd_panel_ops.h"
#include "esp_lcd_panel_st7789.h"
#include "driver/spi_master.h"
#include "driver/gpio.h"
#include "driver/ledc.h"
#include "esp_log.h"
#include "esp_heap_caps.h"
#include "freertos/FreeRTOS.h"
#include "freertos/task.h"
#include <string.h>
#include <stdlib.h>
#include <stdio.h>

static const char *TAG = "lcd_drv";

/* ============================================================
 * 8x16 ASCII 点阵字体 (0x20 ~ 0x5A)
 * 每字符 16 字节，每字节 bit7 对应最左列
 * ============================================================ */
static const uint8_t s_font8x16[][16] = {
    {0x00,0x00,0x00,0x00,0x00,0x00,0x00,0x00,0x00,0x00,0x00,0x00,0x00,0x00,0x00,0x00}, /* 0x20 ' ' */
    {0x00,0x00,0x18,0x3C,0x3C,0x3C,0x18,0x18,0x18,0x00,0x18,0x18,0x00,0x00,0x00,0x00}, /* 0x21 '!' */
    {0x00,0x66,0x66,0x66,0x24,0x00,0x00,0x00,0x00,0x00,0x00,0x00,0x00,0x00,0x00,0x00}, /* 0x22 '"' */
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    {0x00,0x00,0xFE,0xC6,0x86,0x0C,0x18,0x30,0x60,0xC2,0xC6,0xFE,0x00,0x00,0x00,0x00}, /* 0x5A 'Z' */
};

/* ============================================================
 * 内部状态
 * ============================================================ */
static struct {
    esp_lcd_panel_handle_t panel;
    esp_lcd_panel_io_handle_t io;
    lcd_config_t config;
    bool initialized;
    /* 行缓冲区 (用于缩放绘制) */
    uint16_t *line_buf;
    int       line_buf_size;
} s_lcd = {
    .initialized = false,
};

/* ============================================================
 * 内部辅助
 * ============================================================ */

static inline uint16_t rgb565_blend(uint16_t bg, uint16_t fg, uint8_t alpha)
{
    if (alpha == 0)   return bg;
    if (alpha == 255) return fg;

    uint8_t inv = 255 - alpha;
    uint8_t r = (((fg >> 11) & 0x1F) * alpha + ((bg >> 11) & 0x1F) * inv) >> 8;
    uint8_t g = (((fg >>  5) & 0x3F) * alpha + ((bg >>  5) & 0x3F) * inv) >> 8;
    uint8_t b = (((fg      ) & 0x1F) * alpha + ((bg      ) & 0x1F) * inv) >> 8;
    return (uint16_t)((r << 11) | (g << 5) | b);
}

/* ============================================================
 * 公共接口实现
 * ============================================================ */

esp_err_t lcd_driver_init(const lcd_config_t *config)
{
    if (s_lcd.initialized) {
        ESP_LOGW(TAG, "LCD 已初始化");
        return ESP_OK;
    }
    if (!config) return ESP_ERR_INVALID_ARG;

    memcpy(&s_lcd.config, config, sizeof(lcd_config_t));

    /* ---- 配置 SPI 总线 ---- */
    spi_bus_config_t buscfg = {
        .mosi_io_num     = config->pin_mosi,
        .miso_io_num     = -1,
        .sclk_io_num     = config->pin_sclk,
        .quadwp_io_num   = -1,
        .quadhd_io_num   = -1,
        .max_transfer_sz = config->width * config->height * 2 + 8,
    };
    ESP_ERROR_CHECK(spi_bus_initialize(SPI2_HOST, &buscfg, SPI_DMA_CH_AUTO));

    /* ---- 配置 LCD IO ---- */
    esp_lcd_panel_io_spi_config_t io_config = {
        .dc_gpio_num       = config->pin_dc,
        .cs_gpio_num       = config->pin_cs,
        .pclk_hz           = config->spi_clock_hz,
        .lcd_cmd_bits      = 8,
        .lcd_param_bits    = 8,
        .spi_mode          = 0,
        .trans_queue_depth = 10,
    };
    ESP_ERROR_CHECK(esp_lcd_new_panel_io_spi((esp_lcd_spi_bus_handle_t)SPI2_HOST,
                                              &io_config, &s_lcd.io));

    /* ---- 初始化 ST7789 面板 ---- */
    esp_lcd_panel_dev_config_t panel_config = {
        .reset_gpio_num = config->pin_rst,
        .rgb_endian     = LCD_RGB_ENDIAN_RGB,
        .bits_per_pixel = 16,
    };
    ESP_ERROR_CHECK(esp_lcd_new_panel_st7789(s_lcd.io, &panel_config, &s_lcd.panel));

    esp_lcd_panel_reset(s_lcd.panel);
    esp_lcd_panel_init(s_lcd.panel);
    esp_lcd_panel_invert_color(s_lcd.panel, true);   /* ST7789 需要反色 */
    esp_lcd_panel_set_gap(s_lcd.panel, 0, 0);
    esp_lcd_panel_swap_xy(s_lcd.panel, false);
    esp_lcd_panel_mirror(s_lcd.panel, false, false);
    esp_lcd_panel_disp_on_off(s_lcd.panel, true);

    /* ---- 配置背光 (LEDC PWM) ---- */
    if (config->pin_bl >= 0) {
        ledc_timer_config_t ledc_timer = {
            .speed_mode      = LEDC_LOW_SPEED_MODE,
            .timer_num       = LEDC_TIMER_1,
            .duty_resolution = LEDC_TIMER_8_BIT,
            .freq_hz         = 5000,
            .clk_cfg         = LEDC_AUTO_CLK,
        };
        ledc_timer_config(&ledc_timer);

        ledc_channel_config_t ledc_channel = {
            .speed_mode = LEDC_LOW_SPEED_MODE,
            .channel    = LEDC_CHANNEL_1,
            .timer_sel  = LEDC_TIMER_1,
            .intr_type  = LEDC_INTR_DISABLE,
            .gpio_num   = config->pin_bl,
            .duty       = 200,
            .hpoint     = 0,
        };
        ledc_channel_config(&ledc_channel);
    }

    /* ---- 分配行缓冲区 ---- */
    s_lcd.line_buf_size = config->width;
    s_lcd.line_buf = (uint16_t *)heap_caps_malloc(
        s_lcd.line_buf_size * sizeof(uint16_t), MALLOC_CAP_DMA);
    if (!s_lcd.line_buf) {
        ESP_LOGE(TAG, "行缓冲区分配失败");
        return ESP_ERR_NO_MEM;
    }

    s_lcd.initialized = true;
    ESP_LOGI(TAG, "LCD 初始化完成 (%dx%d)", config->width, config->height);

    lcd_clear(LCD_COLOR_BLACK);
    return ESP_OK;
}

void lcd_driver_deinit(void)
{
    if (!s_lcd.initialized) return;
    esp_lcd_panel_del(s_lcd.panel);
    esp_lcd_panel_io_del(s_lcd.io);
    spi_bus_free(SPI2_HOST);
    if (s_lcd.line_buf) {
        free(s_lcd.line_buf);
        s_lcd.line_buf = NULL;
    }
    s_lcd.initialized = false;
}

void lcd_set_backlight(uint8_t brightness)
{
    if (s_lcd.config.pin_bl >= 0) {
        ledc_set_duty(LEDC_LOW_SPEED_MODE, LEDC_CHANNEL_1, brightness);
        ledc_update_duty(LEDC_LOW_SPEED_MODE, LEDC_CHANNEL_1);
    }
}

void lcd_clear(uint16_t color)
{
    lcd_fill_rect(0, 0, s_lcd.config.width, s_lcd.config.height, color);
}

void lcd_draw_bitmap(int x, int y, int w, int h, const uint16_t *pixels)
{
    if (!s_lcd.initialized || !pixels) return;
    esp_lcd_panel_draw_bitmap(s_lcd.panel, x, y, x + w, y + h, pixels);
}

void lcd_draw_bitmap_scaled(int x, int y, int dst_w, int dst_h,
                             const uint16_t *pixels, int src_w, int src_h)
{
    if (!s_lcd.initialized || !pixels) return;

    /* 分配目标行缓冲区 */
    uint16_t *row_buf = (uint16_t *)heap_caps_malloc(
        dst_w * sizeof(uint16_t), MALLOC_CAP_DMA);
    if (!row_buf) {
        ESP_LOGE(TAG, "缩放缓冲区分配失败");
        return;
    }

    for (int dy = 0; dy < dst_h; dy++) {
        int sy = (dy * src_h) / dst_h;
        const uint16_t *src_row = pixels + sy * src_w;

        for (int dx = 0; dx < dst_w; dx++) {
            int sx = (dx * src_w) / dst_w;
            row_buf[dx] = src_row[sx];
        }

        esp_lcd_panel_draw_bitmap(s_lcd.panel,
                                   x, y + dy,
                                   x + dst_w, y + dy + 1,
                                   row_buf);
    }

    free(row_buf);
}

void lcd_fill_rect(int x, int y, int w, int h, uint16_t color)
{
    if (!s_lcd.initialized) return;

    /* 分配一行缓冲区并填充颜色 */
    uint16_t *buf = (uint16_t *)heap_caps_malloc(
        w * sizeof(uint16_t), MALLOC_CAP_DMA);
    if (!buf) return;

    for (int i = 0; i < w; i++) buf[i] = color;

    for (int row = 0; row < h; row++) {
        esp_lcd_panel_draw_bitmap(s_lcd.panel,
                                   x, y + row,
                                   x + w, y + row + 1,
                                   buf);
    }
    free(buf);
}

void lcd_draw_rect(int x, int y, int w, int h, int thickness, uint16_t color)
{
    /* 上边 */
    lcd_fill_rect(x, y, w, thickness, color);
    /* 下边 */
    lcd_fill_rect(x, y + h - thickness, w, thickness, color);
    /* 左边 */
    lcd_fill_rect(x, y, thickness, h, color);
    /* 右边 */
    lcd_fill_rect(x + w - thickness, y, thickness, h, color);
}

void lcd_draw_hline(int x, int y, int len, uint16_t color)
{
    lcd_fill_rect(x, y, len, 1, color);
}

void lcd_draw_vline(int x, int y, int len, uint16_t color)
{
    lcd_fill_rect(x, y, 1, len, color);
}

void lcd_draw_char(int x, int y, char ch, uint16_t fg, uint16_t bg, int scale)
{
    if (!s_lcd.initialized) return;
    if (ch < 0x20 || ch > 0x5A) ch = '?';

    const uint8_t *glyph = s_font8x16[ch - 0x20];
    int char_w = 8 * scale;
    int char_h = 16 * scale;

    uint16_t *buf = (uint16_t *)heap_caps_malloc(
        char_w * char_h * sizeof(uint16_t), MALLOC_CAP_DMA);
    if (!buf) return;

    for (int row = 0; row < 16; row++) {
        uint8_t bits = glyph[row];
        for (int col = 0; col < 8; col++) {
            uint16_t pixel = (bits & (0x80 >> col)) ? fg : bg;
            for (int sy = 0; sy < scale; sy++) {
                for (int sx = 0; sx < scale; sx++) {
                    buf[(row * scale + sy) * char_w + col * scale + sx] = pixel;
                }
            }
        }
    }

    esp_lcd_panel_draw_bitmap(s_lcd.panel,
                               x, y,
                               x + char_w, y + char_h,
                               buf);
    free(buf);
}

void lcd_draw_string(int x, int y, const char *str, uint16_t fg, uint16_t bg, int scale)
{
    if (!str) return;
    int cx = x;
    while (*str) {
        lcd_draw_char(cx, y, *str, fg, bg, scale);
        cx += 8 * scale;
        str++;
    }
}

void lcd_draw_overlay(int x, int y, int w, int h, uint16_t color, uint8_t alpha)
{
    if (!s_lcd.initialized || alpha == 0) return;
    if (alpha == 255) {
        lcd_fill_rect(x, y, w, h, color);
        return;
    }

    /* 半透明叠加：逐行读取背景色并混合 */
    /* 注意：esp_lcd 不支持读回，这里用简化方式：直接绘制带透明度的颜色块 */
    /* 实际效果：将颜色与黑色混合后绘制（近似半透明） */
    uint8_t r = ((color >> 11) & 0x1F) * alpha / 255;
    uint8_t g = ((color >>  5) & 0x3F) * alpha / 255;
    uint8_t b = ((color      ) & 0x1F) * alpha / 255;
    uint16_t blended = (uint16_t)((r << 11) | (g << 5) | b);

    lcd_fill_rect(x, y, w, h, blended);
}

int lcd_get_width(void)
{
    return s_lcd.config.width;
}

int lcd_get_height(void)
{
    return s_lcd.config.height;
}