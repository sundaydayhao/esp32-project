/**
 * @file ssd1306.c
 * @brief SSD1306 OLED 显示屏驱动实现（128x64，I2C）
 */

#include "ssd1306.h"
#include <string.h>
#include "driver/i2c.h"
#include "esp_log.h"

static const char *TAG = "SSD1306";

/* 显示缓冲区 */
static uint8_t s_display_buf[SSD1306_WIDTH * SSD1306_HEIGHT / 8];
static int s_i2c_num;
static uint8_t s_i2c_addr;

/* 8x8 ASCII 字体（从空格 0x20 开始） */
static const uint8_t font8x8[][8] = {
    {0x00,0x00,0x00,0x00,0x00,0x00,0x00,0x00}, /* ' ' */
    {0x00,0x00,0x5F,0x00,0x00,0x00,0x00,0x00}, /* '!' */
    {0x00,0x07,0x00,0x07,0x00,0x00,0x00,0x00}, /* '"' */
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    {0x44,0x64,0x54,0x4C,0x44,0x00,0x00,0x00}, /* 'z' */
};

/**
 * @brief 发送命令到 SSD1306
 */
static esp_err_t ssd1306_send_cmd(uint8_t cmd)
{
    uint8_t buf[2] = {0x00, cmd};  // 0x00 = 命令模式
    return i2c_master_write_to_device(s_i2c_num, s_i2c_addr, buf, 2,
                                       pdMS_TO_TICKS(100));
}

/**
 * @brief 发送数据到 SSD1306
 */
static esp_err_t ssd1306_send_data(const uint8_t *data, size_t len)
{
    uint8_t *buf = malloc(len + 1);
    if (!buf) return ESP_ERR_NO_MEM;
    buf[0] = 0x40;  // 0x40 = 数据模式
    memcpy(buf + 1, data, len);
    esp_err_t ret = i2c_master_write_to_device(s_i2c_num, s_i2c_addr, buf, len + 1,
                                                pdMS_TO_TICKS(100));
    free(buf);
    return ret;
}

esp_err_t ssd1306_init(int i2c_num, uint8_t addr)
{
    s_i2c_num = i2c_num;
    s_i2c_addr = addr;

    /* SSD1306 初始化序列 */
    const uint8_t init_cmds[] = {
        0xAE,       // 关闭显示
        0xD5, 0x80, // 设置时钟分频
        0xA8, 0x3F, // 设置多路复用比（64行）
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        0xAF,       // 开启显示
    };

    for (int i = 0; i < sizeof(init_cmds); i++) {
        esp_err_t ret = ssd1306_send_cmd(init_cmds[i]);
        if (ret != ESP_OK) {
            ESP_LOGE(TAG, "初始化失败，命令 0x%02X", init_cmds[i]);
            return ret;
        }
    }

    ssd1306_clear();
    ssd1306_refresh();

    ESP_LOGI(TAG, "SSD1306 初始化完成，地址: 0x%02X", addr);
    return ESP_OK;
}

void ssd1306_clear(void)
{
    memset(s_display_buf, 0, sizeof(s_display_buf));
}

esp_err_t ssd1306_refresh(void)
{
    /* 设置列地址范围 */
    ssd1306_send_cmd(0x21);
    ssd1306_send_cmd(0);
    ssd1306_send_cmd(SSD1306_WIDTH - 1);

    /* 设置页地址范围 */
    ssd1306_send_cmd(0x22);
    ssd1306_send_cmd(0);
    ssd1306_send_cmd(SSD1306_HEIGHT / 8 - 1);

    /* 发送显示数据 */
    return ssd1306_send_data(s_display_buf, sizeof(s_display_buf));
}

void ssd1306_draw_pixel(int x, int y, bool color)
{
    if (x < 0 || x >= SSD1306_WIDTH || y < 0 || y >= SSD1306_HEIGHT) return;

    int byte_idx = x + (y / 8) * SSD1306_WIDTH;
    int bit_idx = y % 8;

    if (color) {
        s_display_buf[byte_idx] |= (1 << bit_idx);
    } else {
        s_display_buf[byte_idx] &= ~(1 << bit_idx);
    }
}

void ssd1306_draw_hline(int x, int y, int width, bool color)
{
    for (int i = 0; i < width; i++) {
        ssd1306_draw_pixel(x + i, y, color);
    }
}

void ssd1306_draw_vline(int x, int y, int height, bool color)
{
    for (int i = 0; i < height; i++) {
        ssd1306_draw_pixel(x, y + i, color);
    }
}

void ssd1306_draw_rect(int x, int y, int width, int height, bool color)
{
    ssd1306_draw_hline(x, y, width, color);
    ssd1306_draw_hline(x, y + height - 1, width, color);
    ssd1306_draw_vline(x, y, height, color);
    ssd1306_draw_vline(x + width - 1, y, height, color);
}

void ssd1306_fill_rect(int x, int y, int width, int height, bool color)
{
    for (int j = 0; j < height; j++) {
        ssd1306_draw_hline(x, y + j, width, color);
    }
}

void ssd1306_draw_char(int x, int y, char c, bool color)
{
    if (c < 0x20 || c > 0x7A) c = '?';
    int idx = c - 0x20;

    for (int col = 0; col < 8; col++) {
        uint8_t line = font8x8[idx][col];
        for (int row = 0; row < 8; row++) {
            if (line & (1 << row)) {
                ssd1306_draw_pixel(x + col, y + row, color);
            }
        }
    }
}

void ssd1306_draw_string(int x, int y, const char *str, bool color)
{
    while (*str) {
        ssd1306_draw_char(x, y, *str, color);
        x += 8;
        if (x + 8 > SSD1306_WIDTH) {
            x = 0;
            y += 8;
        }
        str++;
    }
}

esp_err_t ssd1306_set_contrast(uint8_t contrast)
{
    ssd1306_send_cmd(0x81);
    return ssd1306_send_cmd(contrast);
}