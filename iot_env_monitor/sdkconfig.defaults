## photo_album/main/Kconfig.projbuild
```kconfig
menu "Photo Album Hardware"

    choice PHOTO_ALBUM_BOARD_TYPE
        prompt "Development board"
        default PHOTO_ALBUM_BOARD_WAVESHARE_7
        help
            Select the target board. The default option keeps the existing
            Waveshare 7-inch RGB LCD path unchanged.

        config PHOTO_ALBUM_BOARD_WAVESHARE_7
            bool "Waveshare ESP32-S3-Touch-LCD-7"

        config PHOTO_ALBUM_BOARD_NT35510
            bool "Generic NT35510 I80 board"
    endchoice

    if PHOTO_ALBUM_BOARD_NT35510

        config PHOTO_ALBUM_NT35510_H_RES
            int "Horizontal resolution"
            range 1 2048
            default 800

        config PHOTO_ALBUM_NT35510_V_RES
            int "Vertical resolution"
            range 1 2048
            default 480

        config PHOTO_ALBUM_NT35510_PIXEL_CLOCK_HZ
            int "I80 pixel clock (Hz)"
            range 1 40000000
            default 8000000

        config PHOTO_ALBUM_NT35510_DRAW_BUF_LINES
            int "I80 flush buffer lines"
            range 1 480
            default 40

        choice PHOTO_ALBUM_NT35510_I80_BUS_WIDTH_CHOICE
            prompt "I80 bus width"
            default PHOTO_ALBUM_NT35510_I80_BUS_WIDTH_16

            config PHOTO_ALBUM_NT35510_I80_BUS_WIDTH_8
                bool "8-bit"

            config PHOTO_ALBUM_NT35510_I80_BUS_WIDTH_16
                bool "16-bit"
        endchoice

        config PHOTO_ALBUM_NT35510_I80_BUS_WIDTH
            int
            default 8 if PHOTO_ALBUM_NT35510_I80_BUS_WIDTH_8
            default 16 if PHOTO_ALBUM_NT35510_I80_BUS_WIDTH_16

        choice PHOTO_ALBUM_NT35510_COLOR_ORDER
            prompt "Panel color order"
            default PHOTO_ALBUM_NT35510_COLOR_ORDER_RGB

            config PHOTO_ALBUM_NT35510_COLOR_ORDER_RGB
                bool "RGB"

            config PHOTO_ALBUM_NT35510_COLOR_ORDER_BGR
                bool "BGR"
        endchoice

        config PHOTO_ALBUM_NT35510_SWAP_XY
            bool "Swap X/Y"
            default y

        config PHOTO_ALBUM_NT35510_MIRROR_X
            bool "Mirror X"
            default y

        config PHOTO_ALBUM_NT35510_MIRROR_Y
            bool "Mirror Y"
            default n

        config PHOTO_ALBUM_NT35510_INVERT_COLOR
            bool "Invert color"
            default n

        config PHOTO_ALBUM_NT35510_SWAP_RGB565_BYTES
            bool "Swap RGB565 bytes before I80 flush"
            default y if PHOTO_ALBUM_NT35510_I80_BUS_WIDTH_8
            default n if PHOTO_ALBUM_NT35510_I80_BUS_WIDTH_16

        config PHOTO_ALBUM_NT35510_PIN_WR
            int "WR pin"
            range -1 48
            default 18

        config PHOTO_ALBUM_NT35510_PIN_CS
            int "CS pin"
            range -1 48
            default 17

        config PHOTO_ALBUM_NT35510_PIN_DC
            int "DC pin"
            range -1 48
            default 16

        config PHOTO_ALBUM_NT35510_PIN_RST
            int "RST pin"
            range -1 48
            default 20

        config PHOTO_ALBUM_NT35510_PIN_BK_LIGHT
            int "Backlight pin"
            range -1 48
            default 38

        config PHOTO_ALBUM_NT35510_PIN_POWER
            int "Panel power-enable pin"
            range -1 48
            default 19

        config PHOTO_ALBUM_NT35510_BK_LIGHT_ACTIVE_HIGH
            bool "Backlight active high"
            default y

        config PHOTO_ALBUM_NT35510_POWER_ACTIVE_HIGH
            bool "Panel power-enable active high"
            default y

        config PHOTO_ALBUM_NT35510_PIN_D0
            int "D0 pin"
            range -1 48
            default 0

        config PHOTO_ALBUM_NT35510_PIN_D1
            int "D1 pin"
            range -1 48
            default 1

        config PHOTO_ALBUM_NT35510_PIN_D2
            int "D2 pin"
            range -1 48
            default 2

        config PHOTO_ALBUM_NT35510_PIN_D3
            int "D3 pin"
            range -1 48
            default 3

        config PHOTO_ALBUM_NT35510_PIN_D4
            int "D4 pin"
            range -1 48
            default 4

        config PHOTO_ALBUM_NT35510_PIN_D5
            int "D5 pin"
            range -1 48
            default 5

        config PHOTO_ALBUM_NT35510_PIN_D6
            int "D6 pin"
            range -1 48
            default 6

        config PHOTO_ALBUM_NT35510_PIN_D7
            int "D7 pin"
            range -1 48
            default 7

        if PHOTO_ALBUM_NT35510_I80_BUS_WIDTH_16

            config PHOTO_ALBUM_NT35510_PIN_D8
                int "D8 pin"
                range -1 48
                default 8

            config PHOTO_ALBUM_NT35510_PIN_D9
                int "D9 pin"
                range -1 48
                default 9

            config PHOTO_ALBUM_NT35510_PIN_D10
                int "D10 pin"
                range -1 48
                default 10

            config PHOTO_ALBUM_NT35510_PIN_D11
                int "D11 pin"
                range -1 48
                default 11

            config PHOTO_ALBUM_NT35510_PIN_D12
                int "D12 pin"
                range -1 48
                default 12

            config PHOTO_ALBUM_NT35510_PIN_D13
                int "D13 pin"
                range -1 48
                default 13

            config PHOTO_ALBUM_NT35510_PIN_D14
                int "D14 pin"
                range -1 48
                default 14

            config PHOTO_ALBUM_NT35510_PIN_D15
                int "D15 pin"
                range -1 48
                default 15

        endif

        config PHOTO_ALBUM_NT35510_SD_SPI_FREQ_KHZ
            int "SD SPI clock (kHz)"
            range 100 40000
            default 20000

        config PHOTO_ALBUM_NT35510_PIN_SD_MOSI
            int "SD MOSI pin"
            range -1 48
            default 41

        config PHOTO_ALBUM_NT35510_PIN_SD_MISO
            int "SD MISO pin"
            range -1 48
            default 39

        config PHOTO_ALBUM_NT35510_PIN_SD_CLK
            int "SD CLK pin"
            range -1 48
            default 40

        config PHOTO_ALBUM_NT35510_PIN_SD_CS
            int "SD CS pin"
            range -1 48
            default 42

    endif

endmenu
```

## photo_album/sdkconfig.defaults
```kconfig
# ============================================================
# ESP32-S3 桌面相册 SDK 配置
# ============================================================

# 目标芯片：ESP32-S3
CONFIG_IDF_TARGET="esp32s3"
CONFIG_PHOTO_ALBUM_BOARD_WAVESHARE_7=y

# CPU 频率 240MHz
CONFIG_ESP_DEFAULT_CPU_FREQ_MHZ_240=y
CONFIG_ESP_DEFAULT_CPU_FREQ_MHZ=240

# PSRAM 配置（必须，用于帧缓冲区）
CONFIG_SPIRAM=y
CONFIG_SPIRAM_MODE_OCT=y
CONFIG_SPIRAM_SPEED_80M=y
CONFIG_SPIRAM_BOOT_INIT=y
CONFIG_SPIRAM_USE_MALLOC=y
CONFIG_SPIRAM_MALLOC_ALWAYSINTERNAL=16384
CONFIG_SPIRAM_MALLOC_RESERVE_INTERNAL=32768

# Flash 配置
CONFIG_ESPTOOLPY_FLASHSIZE_16MB=y
CONFIG_ESPTOOLPY_FLASHSIZE="16MB"
CONFIG_ESPTOOLPY_FLASHFREQ_80M=y
CONFIG_ESPTOOLPY_FLASHMODE_QIO=y

# FreeRTOS
CONFIG_FREERTOS_HZ=1000
CONFIG_FREERTOS_UNICORE=n

# 日志级别
CONFIG_LOG_DEFAULT_LEVEL_INFO=y
CONFIG_LOG_DEFAULT_LEVEL=3

# FAT 文件系统（SD 卡）
CONFIG_FATFS_LFN_HEAP=y
CONFIG_FATFS_MAX_LFN=255
CONFIG_FATFS_CODEPAGE_936=y

# SD/MMC
CONFIG_SOC_SDMMC_HOST_SUPPORTED=y

# LCD / DMA
CONFIG_LCD_RGB_ISR_IRAM_SAFE=y

# JPEG 解码器
CONFIG_JPEG_ENABLE_DEBUG_LOG=n

# 堆内存
CONFIG_HEAP_POISONING_DISABLED=y
CONFIG_HEAP_TRACING_STANDALONE=n

# 看门狗
CONFIG_ESP_TASK_WDT_TIMEOUT_S=30
CONFIG_ESP_TASK_WDT_CHECK_IDLE_TASK_CPU0=n
CONFIG_ESP_TASK_WDT_CHECK_IDLE_TASK_CPU1=n

# 栈大小
CONFIG_ESP_MAIN_TASK_STACK_SIZE=8192
```

## rtlsdr/sdkconfig.defaults
```kconfig
# ESP32-S3 ADS-B Receiver - Default Configuration

# Target
CONFIG_IDF_TARGET="esp32s3"

# Flash
CONFIG_ESPTOOLPY_FLASHSIZE_4MB=y
CONFIG_ESPTOOLPY_FLASHFREQ_80M=y
CONFIG_ESPTOOLPY_FLASHMODE_QIO=y

# Partition Table
CONFIG_PARTITION_TABLE_CUSTOM=y
CONFIG_PARTITION_TABLE_CUSTOM_FILENAME="partitions.csv"

# WiFi
CONFIG_ESP_WIFI_STATIC_RX_BUFFER_NUM=10
CONFIG_ESP_WIFI_DYNAMIC_RX_BUFFER_NUM=32
CONFIG_ESP_WIFI_TX_BUFFER_TYPE_DYNAMIC=y

# LWIP
CONFIG_LWIP_MAX_SOCKETS=16
CONFIG_LWIP_TCP_SND_BUF_DEFAULT=5744
CONFIG_LWIP_TCP_WND_DEFAULT=5744

# HTTP Server
CONFIG_HTTPD_MAX_REQ_HDR_LEN=1024
CONFIG_HTTPD_MAX_URI_LEN=512
CONFIG_HTTPD_WS_SUPPORT=y

# FreeRTOS
CONFIG_FREERTOS_HZ=1000

# Log level
CONFIG_LOG_DEFAULT_LEVEL_INFO=y

# SPIFFS
CONFIG_SPIFFS_MAX_PARTITIONS=1
CONFIG_SPIFFS_OBJ_NAME_LEN=64

# PSRAM (if available on your ESP32-S3 board)
# CONFIG_SPIRAM=y
# CONFIG_SPIRAM_MODE_OCT=y
```

## signal-generator/sdkconfig.defaults
```kconfig
# ESP32-S3 Signal Generator - Default SDK Configuration

# Target chip
CONFIG_IDF_TARGET="esp32s3"

# Enable FreeRTOS
CONFIG_FREERTOS_HZ=1000

# UART console
CONFIG_ESP_CONSOLE_UART_DEFAULT=y
CONFIG_ESP_CONSOLE_UART_NUM=0
CONFIG_ESP_CONSOLE_UART_BAUDRATE=115200

# Enable console component
CONFIG_ESP_CONSOLE_SECONDARY_NONE=y

# Stack sizes
CONFIG_ESP_MAIN_TASK_STACK_SIZE=8192

# Log level
CONFIG_LOG_DEFAULT_LEVEL_INFO=y
CONFIG_LOG_DEFAULT_LEVEL=3

# Compiler optimization
CONFIG_COMPILER_OPTIMIZATION_PERF=y

# Enable math library
CONFIG_NEWLIB_NANO_FORMAT=n

# Timer resolution
CONFIG_ESP_TIMER_TASK_STACK_SIZE=4096

# Partition table
CONFIG_PARTITION_TABLE_SINGLE_APP=y
```

## vc0706-camera/main/Kconfig.projbuild
```kconfig
menu "VC0706 Serial JPEG Camera Test"

    menu "Camera UART"

        config VC0706_UART_NUM
            int "UART port number"
            default 1
            range 0 2
            help
                ESP-IDF UART port used to talk to the VC0706 module.

        config VC0706_UART_TX_GPIO
            int "ESP32 TX GPIO"
            default 3
            range -1 48
            help
                Connect this ESP32 GPIO to camera RX. Arduino SoftwareSerial(2, 3)
                maps to RX=2 and TX=3.

        config VC0706_UART_RX_GPIO
            int "ESP32 RX GPIO"
            default 2
            range -1 48
            help
                Connect this ESP32 GPIO to camera TX.

        config VC0706_UART_BAUD_RATE
            int "UART baud rate"
            default 38400
            range 1200 115200
            help
                Most VC0706 modules default to 38400. Some clones are shipped at 9600.

        config VC0706_UART_RX_BUFFER_SIZE
            int "UART RX buffer size"
            default 2048
            range 512 8192

        config VC0706_COMMAND_TIMEOUT_MS
            int "Command response timeout (ms)"
            default 1200
            range 50 5000

        config VC0706_IMAGE_READ_TIMEOUT_MS
            int "Image data read timeout (ms)"
            default 1500
            range 100 10000

        config VC0706_POWER_UP_DELAY_MS
            int "Camera power-up delay before probe (ms)"
            default 1500
            range 0 5000
            help
                Some VC0706 modules need more than one second after power is
                applied before they answer UART commands.

        config VC0706_INIT_RETRIES
            int "Probe retries per baud rate"
            default 3
            range 1 10

        config VC0706_AUTO_BAUD
            bool "Scan common VC0706 baud rates during init"
            default y
            help
                Try the configured baud rate first, then common values such as
                38400, 9600, 19200, 57600 and 115200.

        config VC0706_READ_DELAY_MS
            int "READ_FBUF delay parameter (ms)"
            default 10
            range 0 65535
            help
                Delay value sent inside READ_FBUF. Keep the default unless the
                module drops bytes at higher UART speeds.

    endmenu

    choice VC0706_IMAGE_SIZE
        prompt "Capture image size"
        default VC0706_IMAGE_SIZE_640X480

        config VC0706_IMAGE_SIZE_640X480
            bool "640x480"

        config VC0706_IMAGE_SIZE_320X240
            bool "320x240"

        config VC0706_IMAGE_SIZE_160X120
            bool "160x120"
    endchoice

    config VC0706_READ_CHUNK_SIZE
        int "JPEG read chunk size"
        default 32
        range 4 255
        help
            Number of bytes read per READ_FBUF command. 32 or 64 is usually the
            safest range for VC0706 modules.

    config VC0706_BUTTON_GPIO
        int "Capture button GPIO"
        default 7
        range -1 48
        help
            Active-low button with internal pull-up. Set -1 to capture once on boot.

    menu "SD Card"

        config VC0706_SAVE_TO_SD
            bool "Save JPEG files to SD card"
            default y

        choice VC0706_SD_SPI_HOST
            prompt "SD SPI host"
            default VC0706_SD_SPI3_HOST
            depends on VC0706_SAVE_TO_SD

            config VC0706_SD_SPI2_HOST
                bool "SPI2_HOST"

            config VC0706_SD_SPI3_HOST
                bool "SPI3_HOST"
        endchoice

        config VC0706_SD_MOSI_GPIO
            int "SD MOSI GPIO"
            default 11
            range -1 48
            depends on VC0706_SAVE_TO_SD

        config VC0706_SD_MISO_GPIO
            int "SD MISO GPIO"
            default 13
            range -1 48
            depends on VC0706_SAVE_TO_SD

        config VC0706_SD_CLK_GPIO
            int "SD CLK GPIO"
            default 12
            range -1 48
            depends on VC0706_SAVE_TO_SD

        config VC0706_SD_CS_GPIO
            int "SD CS GPIO"
            default 4
            range 0 48
            depends on VC0706_SAVE_TO_SD

        config VC0706_SD_SPI_FREQ_KHZ
            int "SD SPI frequency (kHz)"
            default 20000
            range 400 40000
            depends on VC0706_SAVE_TO_SD

    endmenu

endmenu
```

## wifi_analyzer/sdkconfig.defaults
```kconfig
# WiFi 分析仪默认配置

# 增大任务栈，避免 Web 服务器栈溢出
CONFIG_ESP_MAIN_TASK_STACK_SIZE=8192

# WiFi
CONFIG_ESP_WIFI_STATIC_RX_BUFFER_NUM=10
CONFIG_ESP_WIFI_DYNAMIC_RX_BUFFER_NUM=32
CONFIG_ESP_WIFI_TX_BUFFER_TYPE=1

# 日志级别：INFO
CONFIG_LOG_DEFAULT_LEVEL_INFO=y

# HTTP Server 最大 URI 数量
CONFIG_HTTPD_MAX_REQ_HDR_LEN=1024
CONFIG_HTTPD_MAX_URI_LEN=512
```
