## iot_env_monitor/sdkconfig.defaults
```kconfig
# ============================================================
# IoT Environmental Monitor - SDK Configuration Defaults
# ============================================================

# --- CPU & System ---
CONFIG_ESP_DEFAULT_CPU_FREQ_MHZ_240=y
CONFIG_FREERTOS_HZ=1000
CONFIG_ESP_TASK_WDT_TIMEOUT_S=30
CONFIG_ESP_TASK_WDT_INIT=y
CONFIG_ESP_TASK_WDT_CHECK_IDLE_TASK_CPU0=y
CONFIG_ESP_TASK_WDT_CHECK_IDLE_TASK_CPU1=y

# --- Flash & Partition ---
CONFIG_ESPTOOLPY_FLASHSIZE_4MB=y
CONFIG_PARTITION_TABLE_CUSTOM=y
CONFIG_PARTITION_TABLE_CUSTOM_FILENAME="partitions.csv"

# --- WiFi ---
CONFIG_ESP_WIFI_STATIC_RX_BUFFER_NUM=10
CONFIG_ESP_WIFI_DYNAMIC_RX_BUFFER_NUM=32
CONFIG_ESP_WIFI_TX_BUFFER_TYPE=1
CONFIG_ESP_WIFI_AMPDU_TX_ENABLED=y
CONFIG_ESP_WIFI_AMPDU_RX_ENABLED=y

# --- MQTT ---
CONFIG_MQTT_PROTOCOL_311=y
CONFIG_MQTT_TRANSPORT_SSL=y
CONFIG_MQTT_BUFFER_SIZE=4096
CONFIG_MQTT_TASK_STACK_SIZE=6144

# --- LWIP / TCP-IP ---
CONFIG_LWIP_MAX_SOCKETS=16
CONFIG_LWIP_SO_RCVBUF=y
CONFIG_LWIP_IP4_REASSEMBLY=y
CONFIG_LWIP_IP6_REASSEMBLY=y

# --- NVS ---
CONFIG_NVS_ASSERT_ERROR_CHECK=y

# --- OTA ---
CONFIG_ESP_HTTPS_OTA_ALLOW_HTTP=y
CONFIG_BOOTLOADER_APP_ROLLBACK_ENABLE=y

# --- Log Level ---
CONFIG_LOG_DEFAULT_LEVEL_INFO=y
CONFIG_LOG_MAXIMUM_LEVEL_DEBUG=y

# --- SPIFFS ---
CONFIG_SPIFFS_MAX_PARTITIONS=1
CONFIG_SPIFFS_META_LENGTH=4
CONFIG_SPIFFS_USE_MAGIC=y

# --- I2C ---
CONFIG_I2C_ISR_IRAM_SAFE=y

# --- UART ---
CONFIG_UART_ISR_IN_IRAM=y

# --- Heap ---
CONFIG_HEAP_POISONING_DISABLED=y
CONFIG_ESP_SYSTEM_PANIC_PRINT_REBOOT=y
```

## magnifier/main/Kconfig.projbuild
```kconfig
menu "ESP32 Magnifier Configuration"

    config WIFI_SSID
        string "WiFi SSID"
        default "MyWiFi"
        help
            SSID (network name) of the WiFi network to connect to.

    config WIFI_PASSWORD
        string "WiFi Password"
        default "password123"
        help
            WiFi password (WPA/WPA2).

    config WIFI_MAXIMUM_RETRY
        int "Maximum WiFi retry count"
        default 5
        help
            Maximum number of retries when connecting to WiFi.

    choice CAMERA_MODEL
        prompt "Select Camera Board"
        default CAMERA_MODEL_AI_THINKER
        help
            Select the camera board/module being used.

        config CAMERA_MODEL_AI_THINKER
            bool "AI-Thinker ESP32-CAM"
        config CAMERA_MODEL_WROVER_KIT
            bool "ESP-WROVER-KIT"
        config CAMERA_MODEL_ESP_EYE
            bool "ESP-EYE"
        config CAMERA_MODEL_M5STACK_PSRAM
            bool "M5Stack Camera (PSRAM)"
        config CAMERA_MODEL_M5STACK_WIDE
            bool "M5Stack Camera Wide"
    endchoice

    config CAMERA_FRAME_SIZE
        int "Camera Frame Size (0=96x96 ... 13=UXGA 1600x1200)"
        default 6
        range 0 13
        help
            Camera resolution: 5=QVGA(320x240), 6=CIF(400x296),
            8=VGA(640x480), 9=SVGA(800x600), 10=XGA(1024x768),
            13=UXGA(1600x1200). Higher = better quality but slower.

    config CAMERA_JPEG_QUALITY
        int "JPEG Quality (0=best, 63=worst)"
        default 10
        range 0 63
        help
            JPEG compression quality. Lower value = better quality, larger file.

    config HTTP_SERVER_PORT
        int "HTTP Server Port"
        default 80
        help
            Port number for the web server.

endmenu
```

## magnifier/sdkconfig.defaults
```kconfig
# ESP32 Magnifier - Default SDK Configuration

# Increase main task stack size
CONFIG_ESP_MAIN_TASK_STACK_SIZE=8192

# Enable PSRAM (required for high-res camera frames)
CONFIG_ESP32_SPIRAM_SUPPORT=y
CONFIG_SPIRAM_USE_MALLOC=y
CONFIG_SPIRAM_MALLOC_ALWAYSINTERNAL=16384

# Camera frame buffer in PSRAM
CONFIG_CAMERA_CORE0=y

# HTTP Server
CONFIG_HTTPD_MAX_REQ_HDR_LEN=1024
CONFIG_HTTPD_MAX_URI_LEN=512

# WiFi
CONFIG_ESP_WIFI_STATIC_RX_BUFFER_NUM=10
CONFIG_ESP_WIFI_DYNAMIC_RX_BUFFER_NUM=32
CONFIG_ESP_WIFI_TX_BUFFER_TYPE=1
CONFIG_ESP_WIFI_DYNAMIC_TX_BUFFER_NUM=32

# Logging
CONFIG_LOG_DEFAULT_LEVEL_INFO=y

# Partition table
CONFIG_PARTITION_TABLE_SINGLE_APP=y
```

## medication-reminder/main/Kconfig.projbuild
```kconfig
menu "Medication Reminder Configuration"

    menu "WiFi Settings"
        config WIFI_SSID
            string "WiFi SSID"
            default "MyWiFi"
            help
                WiFi网络名称（SSID），用于连接家庭网络

        config WIFI_PASSWORD
            string "WiFi Password"
            default "password123"
            help
                WiFi网络密码

        config WIFI_MAXIMUM_RETRY
            int "Maximum retry count"
            default 5
            help
                WiFi连接最大重试次数，超过后切换到AP模式
    endmenu

    menu "NTP Settings"
        config NTP_SERVER1
            string "NTP Server 1"
            default "ntp.aliyun.com"
            help
                主NTP时间服务器（阿里云）

        config NTP_SERVER2
            string "NTP Server 2"
            default "cn.pool.ntp.org"
            help
                备用NTP时间服务器

        config TIMEZONE
            string "Timezone"
            default "CST-8"
            help
                时区设置，中国标准时间为CST-8
    endmenu

    menu "Hardware Pin Configuration"
        comment "TFT LCD (ILI9341) SPI Pins"

        config LCD_SPI_MOSI
            int "LCD SPI MOSI Pin"
            default 11
            help
                TFT LCD SPI数据引脚（MOSI）

        config LCD_SPI_CLK
            int "LCD SPI CLK Pin"
            default 12
            help
                TFT LCD SPI时钟引脚

        config LCD_CS_PIN
            int "LCD CS Pin"
            default 10
            help
                TFT LCD片选引脚

        config LCD_DC_PIN
            int "LCD DC Pin"
            default 9
            help
                TFT LCD数据/命令选择引脚

        config LCD_RST_PIN
            int "LCD RST Pin"
            default 8
            help
                TFT LCD复位引脚

        config LCD_BL_PIN
            int "LCD Backlight Pin"
            default 7
            help
                TFT LCD背光控制引脚（PWM）

        comment "DS3231 RTC I2C Pins"

        config I2C_SDA_PIN
            int "I2C SDA Pin"
            default 4
            help
                DS3231 RTC I2C数据引脚

        config I2C_SCL_PIN
            int "I2C SCL Pin"
            default 5
            help
                DS3231 RTC I2C时钟引脚

        comment "Buzzer and LED"

        config BUZZER_PIN
            int "Buzzer Pin"
            default 6
            help
                有源蜂鸣器控制引脚

        config LED_RED_PIN
            int "Red LED Pin"
            default 3
            help
                红色LED引脚（提醒状态指示）

        comment "Buttons"

        config BTN_CONFIRM_PIN
            int "Confirm Button Pin"
            default 1
            help
                确认按键引脚（已服药确认），下拉，按下为高电平

        config BTN_PAUSE_PIN
            int "Pause Button Pin"
            default 2
            help
                暂停/历史按键引脚，下拉，按下为高电平
    endmenu

    menu "Reminder Settings"
        config REMINDER_TIMEOUT_MIN
            int "Reminder timeout (minutes)"
            default 5
            range 1 30
            help
                提醒超时时间（分钟），超时后升级为持续蜂鸣

        config REMINDER_ESCALATE_MIN
            int "Escalation timeout (minutes)"
            default 5
            range 1 30
            help
                升级提醒超时时间（分钟），超时后标记为已错过

        config MAX_REMINDERS
            int "Maximum number of reminders"
            default 6
            range 1 8
            help
                最大提醒数量（每日）
    endmenu

    menu "Web Server Settings"
        config AP_SSID
            string "AP Mode SSID"
            default "MedReminder-Config"
            help
                AP配置模式的WiFi名称

        config AP_PASSWORD
            string "AP Mode Password"
            default "12345678"
            help
                AP配置模式的WiFi密码（至少8位）
    endmenu

endmenu
```

## medication-reminder/sdkconfig.defaults
```kconfig
# 分区表
CONFIG_PARTITION_TABLE_CUSTOM=y
CONFIG_PARTITION_TABLE_CUSTOM_FILENAME="partitions.csv"

# Flash大小
CONFIG_ESPTOOLPY_FLASHSIZE_4MB=y

# FreeRTOS配置
CONFIG_FREERTOS_HZ=1000
CONFIG_FREERTOS_TIMER_TASK_STACK_DEPTH=4096

# 主任务栈大小
CONFIG_ESP_MAIN_TASK_STACK_SIZE=8192

# WiFi配置
CONFIG_ESP_WIFI_STATIC_RX_BUFFER_NUM=4
CONFIG_ESP_WIFI_DYNAMIC_RX_BUFFER_NUM=8
CONFIG_ESP_WIFI_STATIC_TX_BUFFER=y
CONFIG_ESP_WIFI_TX_BUFFER_TYPE=0
CONFIG_ESP_WIFI_STATIC_TX_BUFFER_NUM=4

# LWIP配置
CONFIG_LWIP_LOCAL_HOSTNAME="med-reminder"
CONFIG_LWIP_SNTP_MAX_SERVERS=3

# 日志级别
CONFIG_LOG_DEFAULT_LEVEL_INFO=y
CONFIG_LOG_DEFAULT_LEVEL=3

# NVS
CONFIG_NVS_ASSERT_ERROR_CHECK=n

# SPIFFS
CONFIG_SPIFFS_MAX_PARTITIONS=3

# 省电模式关闭
CONFIG_PM_ENABLE=n

# 看门狗
CONFIG_ESP_TASK_WDT_TIMEOUT_S=30

# HTTP服务器
CONFIG_HTTPD_MAX_REQ_HDR_LEN=1024
CONFIG_HTTPD_MAX_URI_LEN=512
```

## music-spectrum/main/Kconfig.projbuild
```kconfig
menu "Music Player Configuration"

    config WIFI_SSID
        string "WiFi SSID"
        default "your_wifi_ssid"
        help
            SSID (network name) for the WiFi network to connect to.

    config WIFI_PASSWORD
        string "WiFi Password"
        default "your_wifi_password"
        help
            WiFi password (WPA or WPA2) for the WiFi network.

    config WIFI_MAXIMUM_RETRY
        int "Maximum retry count"
        default 5
        help
            Set the Maximum retry to avoid station reconnecting to the AP
            unlimited when the AP is really inexistent.

    config I2S_BCK_PIN
        int "I2S BCK (Bit Clock) GPIO"
        default 14
        help
            GPIO number for I2S bit clock signal.

    config I2S_WS_PIN
        int "I2S WS (Word Select / LRCK) GPIO"
        default 15
        help
            GPIO number for I2S word select (left/right clock) signal.

    config I2S_DOUT_PIN
        int "I2S DOUT (Data Out) GPIO"
        default 16
        help
            GPIO number for I2S data output signal.

    config I2S_MCLK_PIN
        int "I2S MCLK GPIO (-1 to disable)"
        default -1
        help
            GPIO number for I2S master clock. Set to -1 if not used.

    config AUDIO_SAMPLE_RATE
        int "Audio Sample Rate (Hz)"
        default 44100
        help
            Audio sample rate in Hz. Common values: 44100, 48000, 22050.

    config AUDIO_BUFFER_SIZE
        int "Audio Decode Buffer Size (bytes)"
        default 4096
        help
            Size of the audio decode buffer in bytes.

    config HTTP_SERVER_PORT
        int "HTTP Server Port"
        default 80
        help
            Port number for the built-in HTTP server.

    config SPIFFS_BASE_PATH
        string "SPIFFS Mount Point"
        default "/spiffs"
        help
            Mount point for the SPIFFS filesystem.

    config MAX_WS_CLIENTS
        int "Maximum WebSocket Clients"
        default 4
        help
            Maximum number of simultaneous WebSocket clients.

    config FFT_SIZE
        int "FFT Size"
        default 512
        help
            Number of samples for FFT computation. Must be power of 2.

endmenu
```

## music-spectrum/sdkconfig.defaults
```kconfig
# WiFi
CONFIG_ESP_WIFI_SSID="your_wifi_ssid"
CONFIG_ESP_WIFI_PASSWORD="your_wifi_password"

# Flash size 16MB
CONFIG_ESPTOOLPY_FLASHSIZE_16MB=y
CONFIG_ESPTOOLPY_FLASHSIZE="16MB"

# Partition table
CONFIG_PARTITION_TABLE_CUSTOM=y
CONFIG_PARTITION_TABLE_CUSTOM_FILENAME="partitions.csv"

# SPIFFS
CONFIG_SPIFFS_MAX_PARTITIONS=3

# HTTP Server
CONFIG_HTTPD_MAX_REQ_HDR_LEN=1024
CONFIG_HTTPD_MAX_URI_LEN=512
CONFIG_HTTPD_WS_SUPPORT=y

# FreeRTOS
CONFIG_FREERTOS_HZ=1000

# Log level
CONFIG_LOG_DEFAULT_LEVEL_INFO=y

# Stack sizes
CONFIG_ESP_MAIN_TASK_STACK_SIZE=8192

# I2S
CONFIG_I2S_SUPPRESS_DEPRECATE_WARN=y

# HTTP Client
CONFIG_ESP_HTTP_CLIENT_ENABLE_HTTPS=y

# Heap
CONFIG_HEAP_POISONING_DISABLED=y

# PSRAM (ESP32-S3 has PSRAM support)
CONFIG_ESP32S3_SPIRAM_SUPPORT=y
CONFIG_SPIRAM_MODE_OCT=y
CONFIG_SPIRAM_SPEED_80M=y
CONFIG_SPIRAM_USE_MALLOC=y
CONFIG_SPIRAM_MALLOC_ALWAYSINTERNAL=16384
```
