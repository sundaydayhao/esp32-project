/**
 * @file lcd12864_gfx.c
 * @brief LCD12864 图形层实现：5x7 字体 + 天气 Emoji 图标（16x16 单色位图）
 */
#include "lcd12864_gfx.h"
#include "lcd12864.h"
#include <string.h>

/* ================================================================
 * 5x7 ASCII 字体（每字符 5 字节，每字节对应一列，bit0=顶部）
 * 字符范围：ASCII 32(' ') ~ 126('~')
 * ================================================================ */
static const uint8_t s_font5x7[][5] = {
    {0x00,0x00,0x00,0x00,0x00}, /* ' ' 32 */
    {0x00,0x00,0x5F,0x00,0x00}, /* '!' 33 */
    {0x00,0x07,0x00,0x07,0x00}, /* '"' 34 */
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    {0x10,0x08,0x08,0x10,0x08}, /* '~' 126 */
};

/* ================================================================
 * 天气图标位图（16x16，每行 2 字节，MSB=左，共 16 行 = 32 字节）
 * 位图格式：byte[2*y] = 左半字节，byte[2*y+1] = 右半字节
 * x=0 对应 byte[2y] bit7，x=15 对应 byte[2y+1] bit0
 * ================================================================ */

/* ☀ 晴天：中心圆 + 8方向射线 */
static const uint8_t s_icon_sunny[32] = {
    0x01,0x80, /* y=0:  .......XX....... */
    0x01,0x80, /* y=1:  .......XX....... */
    0x20,0x04, /* y=2:  ..X..........X.. */
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    0x01,0x80, /* y=15: .......XX....... */
};

/* ⛅ 多云：云朵轮廓 */
static const uint8_t s_icon_cloudy[32] = {
    0x00,0x00, /* y=0  */
    0x00,0x00, /* y=1  */
    0x07,0x00, /* y=2:  .....XXX........ */
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    0x00,0x00, /* y=15 */
};

/* 🌥 阴天：大云朵（填满） */
static const uint8_t s_icon_overcast[32] = {
    0x00,0x00,
    0x03,0xC0, /* y=1:  ......XXXX...... */
    0x0F,0xF0, /* y=2:  ....XXXXXXXX.... */
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    0x00,0x00,
};

/* 🌧 雨天：云 + 雨滴 */
static const uint8_t s_icon_rain[32] = {
    0x00,0x00,
    0x07,0x00, /* y=1:  .....XXX........ */
    0x0F,0x80, /* y=2:  ....XXXXX....... */
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    0x00,0x00,
};

/* ❄ 雪天：雪花（3线交叉） */
static const uint8_t s_icon_snow[32] = {
    0x01,0x80, /* y=0:  .......XX....... 竖线 */
    0x01,0x80, /* y=1  */
    0x21,0x84, /* y=2:  ..X....XX....X.. 斜线 */
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    0x01,0x80, /* y=15 */
};

/* ⚡ 雷电：闪电形状 */
static const uint8_t s_icon_thunder[32] = {
    0x00,0x00,
    0x0F,0xC0, /* y=1:  ....XXXXXX...... */
    0x0F,0x80, /* y=2:  ....XXXXX....... */
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    0x00,0x00,
};

/* 🌫 雾/霾：水平线条 */
static const uint8_t s_icon_fog[32] = {
    0x00,0x00,
    0x00,0x00,
    0xFF,0xFE, /* y=2:  XXXXXXXXXXXXXXX. */
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    0x00,0x00,
};

/* ? 未知：问号图案 */
static const uint8_t s_icon_unknown[32] = {
    0x00,0x00,
    0x07,0xE0, /* y=1:  .....XXXXXX..... */
    0x0F,0xF0, /* y=2:  ....XXXXXXXX.... */
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    0x00,0x00,
};

/* 图标指针表 */
static const uint8_t *s_icons[WEATHER_ICON_COUNT] = {
    s_icon_sunny,
    s_icon_cloudy,
    s_icon_overcast,
    s_icon_rain,
    s_icon_snow,
    s_icon_thunder,
    s_icon_fog,
    s_icon_unknown,
};

/* ================================================================
 * 帧缓冲区（128x64 / 8 = 1024 字节）
 * ================================================================ */
static uint8_t s_fb[1024];

/* ================================================================
 * 内部辅助
 * ================================================================ */
static inline void fb_set_pixel(uint8_t x, uint8_t y, bool on)
{
    if (x >= 128 || y >= 64) return;
    uint16_t idx = (uint16_t)y * 16 + (x >> 3);
    uint8_t  bit = 0x80 >> (x & 7);
    if (on) s_fb[idx] |= bit;
    else    s_fb[idx] &= ~bit;
}

/* ================================================================
 * 公共 API
 * ================================================================ */

void lcd12864_gfx_init(void)
{
    memset(s_fb, 0, sizeof(s_fb));
    lcd12864_enter_graphic_mode();
    lcd12864_flush_bitmap(s_fb);
}

void lcd12864_gfx_clear(void)
{
    memset(s_fb, 0, sizeof(s_fb));
}

void lcd12864_gfx_flush(void)
{
    lcd12864_flush_bitmap(s_fb);
}

void lcd12864_gfx_pixel(uint8_t x, uint8_t y, bool on)
{
    fb_set_pixel(x, y, on);
}

void lcd12864_gfx_hline(uint8_t x, uint8_t y, uint8_t w, bool on)
{
    for (uint8_t i = 0; i < w; i++) {
        fb_set_pixel(x + i, y, on);
    }
}

void lcd12864_gfx_rect(uint8_t x, uint8_t y, uint8_t w, uint8_t h, bool on)
{
    for (uint8_t i = 0; i < w; i++) {
        fb_set_pixel(x + i, y,         on);
        fb_set_pixel(x + i, y + h - 1, on);
    }
    for (uint8_t j = 1; j < h - 1; j++) {
        fb_set_pixel(x,         y + j, on);
        fb_set_pixel(x + w - 1, y + j, on);
    }
}

void lcd12864_gfx_fill_rect(uint8_t x, uint8_t y, uint8_t w, uint8_t h, bool on)
{
    for (uint8_t j = 0; j < h; j++) {
        for (uint8_t i = 0; i < w; i++) {
            fb_set_pixel(x + i, y + j, on);
        }
    }
}

void lcd12864_gfx_char(uint8_t x, uint8_t y, char c, bool on)
{
    if (c < 32 || c > 126) c = '?';
    const uint8_t *glyph = s_font5x7[(uint8_t)c - 32];
    for (uint8_t col = 0; col < 5; col++) {
        uint8_t bits = glyph[col];
        for (uint8_t row = 0; row < 7; row++) {
            fb_set_pixel(x + col, y + row, (bits >> row) & 1 ? on : !on);
        }
    }
}

void lcd12864_gfx_str(uint8_t x, uint8_t y, const char *str, bool on)
{
    if (!str) return;
    uint8_t cx = x;
    while (*str && cx + 5 <= 128) {
        lcd12864_gfx_char(cx, y, *str, on);
        cx += 6;
        str++;
    }
}

void lcd12864_gfx_weather_icon(uint8_t x, uint8_t y, weather_icon_t icon)
{
    if (icon >= WEATHER_ICON_COUNT) icon = WEATHER_ICON_UNKNOWN;
    const uint8_t *bmp = s_icons[icon];
    for (uint8_t row = 0; row < 16; row++) {
        uint8_t hi = bmp[row * 2];
        uint8_t lo = bmp[row * 2 + 1];
        for (uint8_t col = 0; col < 8; col++) {
            fb_set_pixel(x + col,     y + row, (hi >> (7 - col)) & 1);
            fb_set_pixel(x + col + 8, y + row, (lo >> (7 - col)) & 1);
        }
    }
}

weather_icon_t lcd12864_gfx_text_to_icon(const char *text)
{
    if (!text) return WEATHER_ICON_UNKNOWN;

    /* UTF-8 关键字匹配（和风天气 API 返回的中文天气描述） */
    /* "晴" = E6 99 B4 */
    if (strstr(text, "\xE6\x99\xB4")) return WEATHER_ICON_SUNNY;
    /* "雷" = E9 9B B7 */
    if (strstr(text, "\xE9\x9B\xB7")) return WEATHER_ICON_THUNDER;
    /* "雪" = E9 9B AA */
    if (strstr(text, "\xE9\x9B\xAA")) return WEATHER_ICON_SNOW;
    /* "雨" = E9 9B A8 */
    if (strstr(text, "\xE9\x9B\xA8")) return WEATHER_ICON_RAIN;
    /* "雾" = E9 9B BE */
    if (strstr(text, "\xE9\x9B\xBE")) return WEATHER_ICON_FOG;
    /* "霾" = E9 9C BE */
    if (strstr(text, "\xE9\x9C\xBE")) return WEATHER_ICON_FOG;
    /* "阴" = E9 98 B4 */
    if (strstr(text, "\xE9\x98\xB4")) return WEATHER_ICON_OVERCAST;
    /* "云" = E4 BA 91 */
    if (strstr(text, "\xE4\xBA\x91")) return WEATHER_ICON_CLOUDY;
    /* "多云" 已被上面"云"匹配 */

    return WEATHER_ICON_UNKNOWN;
}