/**
 * @file ssd1306.c
 * @brief SSD1306 OLED 驱动实现
 */

#include "ssd1306.h"
#include "config.h"
#include "driver/i2c.h"
#include "esp_log.h"
#include <string.h>
#include <stdio.h>

static const char *TAG = "ssd1306";

// ============================================================
// 5x7 ASCII 字体 (字符 0x20 ~ 0x7E, 每字符5字节列数据)
// ============================================================
static const uint8_t s_font5x7[][5] = {
    {0x00,0x00,0x00,0x00,0x00}, // 0x20 ' '
    {0x00,0x00,0x5F,0x00,0x00}, // 0x21 '!'
    {0x00,0x07,0x00,0x07,0x00}, // 0x22 '"'
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    {0x10,0x08,0x08,0x10,0x08}, // 0x7E '~'
};

// ============================================================
// 帧缓冲 (128 * 64 / 8 = 1024 字节)
// ============================================================
static uint8_t s_framebuf[SSD1306_PAGES][SSD1306_WIDTH];

// ============================================================
// I2C 辅助函数
// ============================================================

#define I2C_TIMEOUT_MS  100

static esp_err_t i2c_write_byte(uint8_t ctrl, uint8_t data)
{
    uint8_t buf[2] = {ctrl, data};
    return i2c_master_write_to_device(OLED_I2C_PORT, OLED_I2C_ADDR,
                                       buf, 2,
                                       pdMS_TO_TICKS(I2C_TIMEOUT_MS));
}

static esp_err_t i2c_write_cmd(uint8_t cmd)
{
    return i2c_write_byte(0x00, cmd); // Co=0, D/C#=0 -> 命令
}

static esp_err_t i2c_write_data_buf(const uint8_t *data, size_t len)
{
    // 构建带控制字节的缓冲区
    uint8_t buf[SSD1306_WIDTH + 1];
    buf[0] = 0x40; // Co=0, D/C#=1 -> 数据
    memcpy(buf + 1, data, len);
    return i2c_master_write_to_device(OLED_I2C_PORT, OLED_I2C_ADDR,
                                       buf, len + 1,
                                       pdMS_TO_TICKS(I2C_TIMEOUT_MS));
}

// ============================================================
// 初始化序列
// ============================================================

esp_err_t ssd1306_init(void)
{
    // 初始化 I2C
    i2c_config_t i2c_conf = {
        .mode             = I2C_MODE_MASTER,
        .sda_io_num       = OLED_SDA_GPIO,
        .scl_io_num       = OLED_SCL_GPIO,
        .sda_pullup_en    = GPIO_PULLUP_ENABLE,
        .scl_pullup_en    = GPIO_PULLUP_ENABLE,
        .master.clk_speed = OLED_I2C_FREQ_HZ,
    };
    esp_err_t ret = i2c_param_config(OLED_I2C_PORT, &i2c_conf);
    if (ret != ESP_OK) {
        ESP_LOGE(TAG, "I2C参数配置失败: %s", esp_err_to_name(ret));
        return ret;
    }

    ret = i2c_driver_install(OLED_I2C_PORT, I2C_MODE_MASTER, 0, 0, 0);
    if (ret != ESP_OK) {
        ESP_LOGE(TAG, "I2C驱动安装失败: %s", esp_err_to_name(ret));
        return ret;
    }

    // SSD1306 初始化命令序列
    const uint8_t init_cmds[] = {
        0xAE,       // 关闭显示
        0xD5, 0x80, // 设置时钟分频/振荡频率
        0xA8, 0x3F, // 设置多路复用比 (64-1)
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        0xAF,       // 开启显示
    };

    for (size_t i = 0; i < sizeof(init_cmds); i++) {
        ret = i2c_write_cmd(init_cmds[i]);
        if (ret != ESP_OK) {
            ESP_LOGE(TAG, "SSD1306初始化命令0x%02X失败", init_cmds[i]);
            return ret;
        }
    }

    // 清屏
    ssd1306_clear_screen();

    ESP_LOGI(TAG, "SSD1306 初始化成功 (%dx%d)", SSD1306_WIDTH, SSD1306_HEIGHT);
    return ESP_OK;
}

// ============================================================
// 帧缓冲操作
// ============================================================

void ssd1306_clear(void)
{
    memset(s_framebuf, 0, sizeof(s_framebuf));
}

void ssd1306_flush(void)
{
    // 设置列地址范围 0~127
    i2c_write_cmd(0x21);
    i2c_write_cmd(0x00);
    i2c_write_cmd(0x7F);

    // 设置页地址范围 0~7
    i2c_write_cmd(0x22);
    i2c_write_cmd(0x00);
    i2c_write_cmd(0x07);

    // 逐页写入数据
    for (int page = 0; page < SSD1306_PAGES; page++) {
        i2c_write_data_buf(s_framebuf[page], SSD1306_WIDTH);
    }
}

void ssd1306_clear_screen(void)
{
    ssd1306_clear();
    ssd1306_flush();
}

// ============================================================
// 绘图函数
// ============================================================

void ssd1306_draw_pixel(uint8_t x, uint8_t y, bool color)
{
    if (x >= SSD1306_WIDTH || y >= SSD1306_HEIGHT) return;
    uint8_t page = y / 8;
    uint8_t bit  = y % 8;
    if (color) {
        s_framebuf[page][x] |=  (1 << bit);
    } else {
        s_framebuf[page][x] &= ~(1 << bit);
    }
}

void ssd1306_draw_hline(uint8_t x, uint8_t y, uint8_t width, bool color)
{
    for (uint8_t i = 0; i < width && (x + i) < SSD1306_WIDTH; i++) {
        ssd1306_draw_pixel(x + i, y, color);
    }
}

void ssd1306_draw_vline(uint8_t x, uint8_t y, uint8_t height, bool color)
{
    for (uint8_t i = 0; i < height && (y + i) < SSD1306_HEIGHT; i++) {
        ssd1306_draw_pixel(x, y + i, color);
    }
}

void ssd1306_draw_rect(uint8_t x, uint8_t y,
                        uint8_t width, uint8_t height, bool color)
{
    ssd1306_draw_hline(x, y, width, color);
    ssd1306_draw_hline(x, y + height - 1, width, color);
    ssd1306_draw_vline(x, y, height, color);
    ssd1306_draw_vline(x + width - 1, y, height, color);
}

void ssd1306_fill_rect(uint8_t x, uint8_t y,
                        uint8_t width, uint8_t height, bool color)
{
    for (uint8_t row = 0; row < height; row++) {
        ssd1306_draw_hline(x, y + row, width, color);
    }
}

void ssd1306_draw_char(uint8_t x, uint8_t y, char ch, bool color)
{
    if (ch < 0x20 || ch > 0x7E) ch = '?';
    const uint8_t *glyph = s_font5x7[ch - 0x20];

    for (int col = 0; col < 5; col++) {
        uint8_t col_data = glyph[col];
        for (int row = 0; row < 7; row++) {
            if (col_data & (1 << row)) {
                ssd1306_draw_pixel(x + col, y + row, color);
            } else {
                ssd1306_draw_pixel(x + col, y + row, !color);
            }
        }
    }
    // 字符间距列 (清空)
    for (int row = 0; row < 8; row++) {
        ssd1306_draw_pixel(x + 5, y + row, !color);
    }
}

void ssd1306_draw_string(uint8_t x, uint8_t y, const char *str, bool color)
{
    if (!str) return;
    uint8_t cx = x;
    while (*str && cx + FONT_WIDTH <= SSD1306_WIDTH) {
        ssd1306_draw_char(cx, y, *str, color);
        cx += FONT_WIDTH;
        str++;
    }
}

void ssd1306_draw_string_centered(uint8_t row, const char *str, bool color)
{
    if (!str) return;
    int len = 0;
    while (str[len]) len++;
    int total_width = len * FONT_WIDTH;
    int x = (SSD1306_WIDTH - total_width) / 2;
    if (x < 0) x = 0;
    ssd1306_draw_string((uint8_t)x, row * FONT_HEIGHT, str, color);
}

void ssd1306_set_contrast(uint8_t contrast)
{
    i2c_write_cmd(0x81);
    i2c_write_cmd(contrast);
}

void ssd1306_display_on(bool on)
{
    i2c_write_cmd(on ? 0xAF : 0xAE);
}