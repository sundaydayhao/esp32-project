#include "lcd_driver.h"
#include "driver/spi_master.h"
#include "driver/gpio.h"
#include "driver/ledc.h"
#include "esp_log.h"
#include "freertos/FreeRTOS.h"
#include "freertos/semphr.h"
#include "freertos/task.h"
#include <string.h>
#include <stdlib.h>

static const char *TAG = "lcd_driver";
static spi_device_handle_t s_spi = NULL;
static SemaphoreHandle_t s_lcd_mutex = NULL;

// ============================================================
// 标准 8×16 ASCII 点阵字库（0x20~0x7E，共 95 个字符）
// 每字符 16 字节，每字节表示一行（bit7 = 最左列）
// ============================================================
static const uint8_t FONT8x16[95][16] = {
    {0x00,0x00,0x00,0x00,0x00,0x00,0x00,0x00,0x00,0x00,0x00,0x00,0x00,0x00,0x00,0x00}, // 0x20 ' '
    {0x00,0x00,0x18,0x18,0x18,0x18,0x18,0x18,0x18,0x00,0x18,0x18,0x00,0x00,0x00,0x00}, // 0x21 '!'
    {0x00,0x66,0x66,0x66,0x24,0x00,0x00,0x00,0x00,0x00,0x00,0x00,0x00,0x00,0x00,0x00}, // 0x22 '"'
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    {0x00,0x00,0x76,0xDC,0x00,0x00,0x00,0x00,0x00,0x00,0x00,0x00,0x00,0x00,0x00,0x00}, // 0x7E '~'
};

// ============================================================
// SPI 底层操作
// ============================================================
static bool lcd_lock(void) {
    if (s_lcd_mutex == NULL) {
        ESP_LOGE(TAG, "LCD mutex not initialized");
        return false;
    }

    return xSemaphoreTakeRecursive(s_lcd_mutex, portMAX_DELAY) == pdTRUE;
}

static void lcd_unlock(void) {
    if (s_lcd_mutex != NULL) {
        xSemaphoreGiveRecursive(s_lcd_mutex);
    }
}

static esp_err_t lcd_spi_polling_transmit(spi_transaction_t *t, const char *context) {
    esp_err_t ret = spi_device_polling_transmit(s_spi, t);
    if (ret != ESP_OK) {
        ESP_LOGE(TAG, "%s failed: %s", context, esp_err_to_name(ret));
    }
    return ret;
}

static esp_err_t lcd_cmd(uint8_t cmd) {
    gpio_set_level(LCD_PIN_DC, 0);
    spi_transaction_t t = {
        .length = 8,
        .flags = SPI_TRANS_USE_TXDATA,
    };
    t.tx_data[0] = cmd;
    return lcd_spi_polling_transmit(&t, "lcd_cmd");
}

static esp_err_t lcd_data_byte(uint8_t data) {
    gpio_set_level(LCD_PIN_DC, 1);
    spi_transaction_t t = {
        .length = 8,
        .flags = SPI_TRANS_USE_TXDATA,
    };
    t.tx_data[0] = data;
    return lcd_spi_polling_transmit(&t, "lcd_data_byte");
}

static esp_err_t lcd_data_buf(const uint8_t *data, size_t len) {
    if (len == 0) return ESP_OK;

    gpio_set_level(LCD_PIN_DC, 1);
    spi_transaction_t t = {
        .length = len * 8,
    };
    if (len <= sizeof(t.tx_data)) {
        t.flags = SPI_TRANS_USE_TXDATA;
        memcpy(t.tx_data, data, len);
    } else {
        t.tx_buffer = data;
    }

    return lcd_spi_polling_transmit(&t, "lcd_data_buf");
}

// ============================================================
// ILI9488 初始化序列
// ============================================================
static void ili9488_init_sequence(void) {
    // 硬件复位
    gpio_set_level(LCD_PIN_RST, 0);
    vTaskDelay(pdMS_TO_TICKS(10));
    gpio_set_level(LCD_PIN_RST, 1);
    vTaskDelay(pdMS_TO_TICKS(120));

    if (lcd_cmd(ILI9488_CMD_SWRESET) != ESP_OK) return;
    vTaskDelay(pdMS_TO_TICKS(120));

    // 电源控制
    if (lcd_cmd(ILI9488_CMD_PWCTRL1) != ESP_OK) return;
    if (lcd_data_byte(0x17) != ESP_OK) return;
    if (lcd_data_byte(0x15) != ESP_OK) return;

    if (lcd_cmd(ILI9488_CMD_PWCTRL2) != ESP_OK) return;
    if (lcd_data_byte(0x41) != ESP_OK) return;

    if (lcd_cmd(ILI9488_CMD_VMCTRL1) != ESP_OK) return;
    if (lcd_data_byte(0x00) != ESP_OK) return;
    if (lcd_data_byte(0x12) != ESP_OK) return;
    if (lcd_data_byte(0x80) != ESP_OK) return;

    // 内存访问控制（横屏，BGR）
    if (lcd_cmd(ILI9488_CMD_MADCTL) != ESP_OK) return;
    if (lcd_data_byte(MADCTL_MX | MADCTL_BGR) != ESP_OK) return;

    // 像素格式：16位 RGB565
    if (lcd_cmd(ILI9488_CMD_COLMOD) != ESP_OK) return;
    if (lcd_data_byte(0x55) != ESP_OK) return;

    // Gamma 正极
    if (lcd_cmd(ILI9488_CMD_PGAMCTRL) != ESP_OK) return;
    const uint8_t pgam[] = {0x00,0x03,0x09,0x08,0x16,0x0A,0x3F,0x78,0x4C,0x09,0x0A,0x08,0x16,0x1A,0x0F};
    if (lcd_data_buf(pgam, sizeof(pgam)) != ESP_OK) return;

    // Gamma 负极
    if (lcd_cmd(ILI9488_CMD_NGAMCTRL) != ESP_OK) return;
    const uint8_t ngam[] = {0x00,0x16,0x19,0x03,0x0F,0x05,0x32,0x45,0x46,0x04,0x0E,0x0D,0x35,0x37,0x0F};
    if (lcd_data_buf(ngam, sizeof(ngam)) != ESP_OK) return;

    // 退出睡眠
    if (lcd_cmd(ILI9488_CMD_SLPOUT) != ESP_OK) return;
    vTaskDelay(pdMS_TO_TICKS(120));

    // 开启显示
    if (lcd_cmd(ILI9488_CMD_DISPON) != ESP_OK) return;
    vTaskDelay(pdMS_TO_TICKS(20));

    ESP_LOGI(TAG, "ILI9488 initialized (%dx%d)", LCD_WIDTH, LCD_HEIGHT);
}

// ============================================================
// 公共接口实现
// ============================================================
void lcd_init(void) {
    if (s_lcd_mutex == NULL) {
        s_lcd_mutex = xSemaphoreCreateRecursiveMutex();
        ESP_ERROR_CHECK(s_lcd_mutex == NULL ? ESP_ERR_NO_MEM : ESP_OK);
    }
    if (!lcd_lock()) return;
    // 配置 GPIO
    gpio_config_t io_conf = {
        .pin_bit_mask = (1ULL << LCD_PIN_DC) | (1ULL << LCD_PIN_RST) | (1ULL << LCD_PIN_BL),
        .mode = GPIO_MODE_OUTPUT,
        .pull_up_en = GPIO_PULLUP_DISABLE,
        .pull_down_en = GPIO_PULLDOWN_DISABLE,
        .intr_type = GPIO_INTR_DISABLE,
    };
    gpio_config(&io_conf);
    gpio_set_level(LCD_PIN_BL, 0);  // 背光先关

    // 配置 SPI
    spi_bus_config_t buscfg = {
        .mosi_io_num = LCD_PIN_MOSI,
        .miso_io_num = -1,
        .sclk_io_num = LCD_PIN_SCLK,
        .quadwp_io_num = -1,
        .quadhd_io_num = -1,
        .max_transfer_sz = LCD_WIDTH * 16 * 2,  // 一次最多传输16行
    };
    ESP_ERROR_CHECK(spi_bus_initialize(LCD_SPI_HOST, &buscfg, SPI_DMA_CH_AUTO));

    spi_device_interface_config_t devcfg = {
        .clock_speed_hz = LCD_SPI_FREQ_HZ,
        .mode = 0,
        .spics_io_num = LCD_PIN_CS,
        .queue_size = 7,
        .pre_cb = NULL,
    };
    ESP_ERROR_CHECK(spi_bus_add_device(LCD_SPI_HOST, &devcfg, &s_spi));

    // 配置背光 PWM
    ledc_timer_config_t ledc_timer = {
        .speed_mode = LEDC_LOW_SPEED_MODE,
        .timer_num = LEDC_TIMER_0,
        .duty_resolution = LEDC_TIMER_8_BIT,
        .freq_hz = 5000,
        .clk_cfg = LEDC_AUTO_CLK,
    };
    ledc_timer_config(&ledc_timer);

    ledc_channel_config_t ledc_channel = {
        .speed_mode = LEDC_LOW_SPEED_MODE,
        .channel = LEDC_CHANNEL_0,
        .timer_sel = LEDC_TIMER_0,
        .intr_type = LEDC_INTR_DISABLE,
        .gpio_num = LCD_PIN_BL,
        .duty = 0,
        .hpoint = 0,
    };
    ledc_channel_config(&ledc_channel);

    // 执行 ILI9488 初始化
    ili9488_init_sequence();

    // 清屏为黑色
    lcd_clear(COLOR_BLACK);

    // 开启背光（最大亮度）
    lcd_set_backlight(255);
    lcd_unlock();
}

void lcd_set_window(uint16_t x0, uint16_t y0, uint16_t x1, uint16_t y1) {
    if (!lcd_lock()) return;

    if (lcd_cmd(ILI9488_CMD_CASET) != ESP_OK) {
        lcd_unlock();
        return;
    }
    if (lcd_data_byte(x0 >> 8) != ESP_OK || lcd_data_byte(x0 & 0xFF) != ESP_OK ||
        lcd_data_byte(x1 >> 8) != ESP_OK || lcd_data_byte(x1 & 0xFF) != ESP_OK) {
        lcd_unlock();
        return;
    }

    if (lcd_cmd(ILI9488_CMD_PASET) != ESP_OK) {
        lcd_unlock();
        return;
    }
    if (lcd_data_byte(y0 >> 8) != ESP_OK || lcd_data_byte(y0 & 0xFF) != ESP_OK ||
        lcd_data_byte(y1 >> 8) != ESP_OK || lcd_data_byte(y1 & 0xFF) != ESP_OK) {
        lcd_unlock();
        return;
    }

    (void)lcd_cmd(ILI9488_CMD_RAMWR);
    lcd_unlock();
}

void lcd_fill_rect(uint16_t x, uint16_t y, uint16_t w, uint16_t h, uint16_t color) {
    if (w == 0 || h == 0) return;
    if (!lcd_lock()) return;
    lcd_set_window(x, y, x + w - 1, y + h - 1);

    // 准备行缓冲区（一次发送一行）
    uint16_t *line_buf = heap_caps_malloc(w * 2, MALLOC_CAP_DMA);
    if (!line_buf) {
        ESP_LOGE(TAG, "Failed to allocate %u-byte DMA line buffer", (unsigned)(w * 2));
        lcd_unlock();
        return;
    }

    // 填充颜色（注意 ILI9488 需要大端字节序）
    uint16_t color_be = (color >> 8) | (color << 8);
    for (int i = 0; i < w; i++) line_buf[i] = color_be;

    gpio_set_level(LCD_PIN_DC, 1);
    for (int row = 0; row < h; row++) {
        spi_transaction_t t = {
            .length = w * 16,
            .tx_buffer = line_buf,
        };
        if (lcd_spi_polling_transmit(&t, "lcd_fill_rect") != ESP_OK) {
            break;
        }
    }
    free(line_buf);
    lcd_unlock();
}

void lcd_draw_pixel(uint16_t x, uint16_t y, uint16_t color) {
    if (!lcd_lock()) return;
    lcd_set_window(x, y, x, y);
    uint8_t data[2] = {color >> 8, color & 0xFF};
    (void)lcd_data_buf(data, 2);
    lcd_unlock();
}

void lcd_draw_hline(uint16_t x, uint16_t y, uint16_t len, uint16_t color) {
    if (!lcd_lock()) return;
    lcd_fill_rect(x, y, len, 1, color);
    lcd_unlock();
}

void lcd_draw_vline(uint16_t x, uint16_t y, uint16_t len, uint16_t color) {
    if (!lcd_lock()) return;
    lcd_fill_rect(x, y, 1, len, color);
    lcd_unlock();
}

void lcd_draw_rect(uint16_t x, uint16_t y, uint16_t w, uint16_t h, uint16_t color) {
    if (!lcd_lock()) return;
    lcd_draw_hline(x, y, w, color);
    lcd_draw_hline(x, y + h - 1, w, color);
    lcd_draw_vline(x, y, h, color);
    lcd_draw_vline(x + w - 1, y, h, color);
    lcd_unlock();
}

void lcd_draw_bitmap(uint16_t x, uint16_t y, uint16_t w, uint16_t h, const uint16_t *data) {
    if (!lcd_lock()) return;
    lcd_set_window(x, y, x + w - 1, y + h - 1);
    gpio_set_level(LCD_PIN_DC, 1);

    // 逐行发送（处理字节序转换）
    uint16_t *line_buf = heap_caps_malloc(w * 2, MALLOC_CAP_DMA);
    if (!line_buf) {
        ESP_LOGE(TAG, "Failed to allocate %u-byte DMA bitmap buffer", (unsigned)(w * 2));
        lcd_unlock();
        return;
    }

    for (int row = 0; row < h; row++) {
        for (int col = 0; col < w; col++) {
            uint16_t c = data[row * w + col];
            line_buf[col] = (c >> 8) | (c << 8);  // 大端转换
        }
        spi_transaction_t t = {
            .length = w * 16,
            .tx_buffer = line_buf,
        };
        if (lcd_spi_polling_transmit(&t, "lcd_draw_bitmap") != ESP_OK) {
            break;
        }
    }
    free(line_buf);
    lcd_unlock();
}

void lcd_clear(uint16_t color) {
    if (!lcd_lock()) return;
    lcd_fill_rect(0, 0, LCD_WIDTH, LCD_HEIGHT, color);
    lcd_unlock();
}

void lcd_set_backlight(uint8_t brightness) {
    if (!lcd_lock()) return;
    ledc_set_duty(LEDC_LOW_SPEED_MODE, LEDC_CHANNEL_0, brightness);
    ledc_update_duty(LEDC_LOW_SPEED_MODE, LEDC_CHANNEL_0);
    lcd_unlock();
}

// ============================================================
// 字符绘制
// ============================================================
void lcd_draw_char(uint16_t x, uint16_t y, char c, uint16_t fg, uint16_t bg, uint8_t scale) {
    if (!lcd_lock()) return;
    if (c < 0x20 || c > 0x7E) c = '?';
    const uint8_t *glyph = FONT8x16[c - 0x20];

    for (int row = 0; row < 16; row++) {
        uint8_t bits = glyph[row];
        for (int col = 0; col < 8; col++) {
            uint16_t color = (bits & (0x80 >> col)) ? fg : bg;
            if (scale == 1) {
                lcd_draw_pixel(x + col, y + row, color);
            } else {
                lcd_fill_rect(x + col * scale, y + row * scale, scale, scale, color);
            }
        }
    }
    lcd_unlock();
}

void lcd_draw_string(uint16_t x, uint16_t y, const char *str, uint16_t fg, uint16_t bg, uint8_t scale) {
    if (!lcd_lock()) return;
    uint16_t cx = x;
    while (*str) {
        if (*str == '\n') {
            cx = x;
            y += 16 * scale;
        } else {
            lcd_draw_char(cx, y, *str, fg, bg, scale);
            cx += 8 * scale;
        }
        str++;
    }
    lcd_unlock();
}

// ============================================================
// UTF-8 中文字符绘制
// 使用 16×16 点阵字库（存储在 SPIFFS 中）
// 字库文件格式：每个汉字 32 字节（16行×2字节/行）
// 文件名：/spiffs/font16.bin，按 Unicode 码点排序
// ============================================================
#include "esp_spiffs.h"
#include <stdio.h>

static FILE *s_font_file = NULL;

static bool font_open(void) {
    if (s_font_file) return true;
    s_font_file = fopen("/spiffs/font16.bin", "rb");
    return s_font_file != NULL;
}

// UTF-8 解码：返回 Unicode 码点，更新指针
static uint32_t utf8_decode(const char **p) {
    uint8_t c = (uint8_t)**p;
    uint32_t cp;
    if (c < 0x80) {
        cp = c; (*p)++;
    } else if ((c & 0xE0) == 0xC0) {
        cp = (c & 0x1F) << 6 | ((uint8_t)*(*p+1) & 0x3F);
        *p += 2;
    } else if ((c & 0xF0) == 0xE0) {
        cp = (c & 0x0F) << 12 | ((uint8_t)*(*p+1) & 0x3F) << 6 | ((uint8_t)*(*p+2) & 0x3F);
        *p += 3;
    } else {
        cp = '?'; (*p)++;
    }
    return cp;
}

void lcd_draw_utf8(uint16_t x, uint16_t y, const char *utf8_str,
                   uint16_t fg, uint16_t bg, uint8_t scale) {
    if (!lcd_lock()) return;
    uint16_t cx = x;
    const char *p = utf8_str;

    while (*p) {
        uint32_t cp = utf8_decode(&p);

        if (cp < 0x80) {
            // ASCII 字符：8×16
            lcd_draw_char(cx, y, (char)cp, fg, bg, scale);
            cx += 8 * scale;
        } else {
            // 中文字符：16×16，从字库文件读取
            uint8_t glyph[32] = {0};
            bool found = false;

            if (font_open()) {
                // 字库索引：Unicode - 0x4E00（CJK统一汉字起始）
                // 简化：直接按偏移查找（需要字库按 Unicode 顺序排列）
                if (cp >= 0x4E00 && cp <= 0x9FFF) {
                    long offset = (long)(cp - 0x4E00) * 32;
                    if (fseek(s_font_file, offset, SEEK_SET) == 0) {
                        if (fread(glyph, 1, 32, s_font_file) == 32) {
                            found = true;
                        }
                    }
                }
            }

            if (found) {
                // 绘制 16×16 汉字
                for (int row = 0; row < 16; row++) {
                    uint16_t bits = ((uint16_t)glyph[row * 2] << 8) | glyph[row * 2 + 1];
                    for (int col = 0; col < 16; col++) {
                        uint16_t color = (bits & (0x8000 >> col)) ? fg : bg;
                        if (scale == 1) {
                            lcd_draw_pixel(cx + col, y + row, color);
                        } else {
                            lcd_fill_rect(cx + col * scale, y + row * scale, scale, scale, color);
                        }
                    }
                }
            } else {
                // 字库未找到，绘制方块占位
                lcd_draw_rect(cx, y, 16 * scale, 16 * scale, fg);
            }
            cx += 16 * scale;
        }
    }
    lcd_unlock();
}
